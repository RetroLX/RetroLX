## package/retrolx/kernels/retrolx-kernel-s922x/Config.in
```kconfig
config BR2_PACKAGE_RETROLX_KERNEL_S922X
        bool "retrolx-kernel-s922x"
        help
          Amlogic S922X / A311D Linux kernel for RetroLX
```

## package/retrolx/kernels/retrolx-kernel-sun50i/Config.in
```kconfig
config BR2_PACKAGE_RETROLX_KERNEL_SUN50I
        bool "retrolx-kernel-sun50i"
        help
          Allwinner H5 / H6 Linux kernel for RetroLX
```

## package/retrolx/kernels/retrolx-kernel-x86_64/Config.in
```kconfig
config BR2_PACKAGE_RETROLX_KERNEL_X86_64
        bool "retrolx-kernel-x86-64"
        help
          Generic x86-64 Linux kernel for RetroLX
```

## package/retrolx/kernels/retrolx-kernels/Config.in
```kconfig
config BR2_PACKAGE_RETROLX_KERNELS
        bool "retrolx-kernels"
        help
          Linux kernel for RetroLX
```

## package/retrolx/libraries/appstream-glib/Config.in
```kconfig
config BR2_PACKAGE_APPSTREAM_GLIB
	bool "appstream-glib"
	depends on BR2_PACKAGE_LIBGTK3
	depends on BR2_PACKAGE_LIBYAML
	depends on BR2_PACKAGE_JSON_GLIB

	help 
	appstream-glib library
```

## package/retrolx/libraries/ksmbd-tools/Config.in
```kconfig
config BR2_PACKAGE_KSMBD_TOOLS
	bool "ksmbd-tools"
	depends on BR2_PACKAGE_LIBGLIB2
	depends on BR2_PACKAGE_LIBNL
	help
	  Tools to use KSMBD Linux kernel SMB server
	
	  https://github.com/namjaejeon/ksmbd-tools
```

## package/retrolx/libraries/libfreeaptx/Config.in
```kconfig
config BR2_PACKAGE_LIBFREEAPTX
	bool "libfreeaptx"
	help
	  Open Source implementation of Audio Processing Technology codec (aptX)

	  https://github.com/iamthehorker/libfreeaptx
```

## package/retrolx/libraries/tbb/Config.in
```kconfig
config BR2_PACKAGE_TBB
	bool "tbb"
	help
	  oneAPI Threading Building Blocks (oneTBB) lets you easily write parallel C++ programs 
	  that take full advantage of multicore performance, that are portable, composable and 
	  have future-proof scalability.

	  https://github.com/oneapi-src/oneTBB
```

## package/retrolx/libraries/timidity/Config.in
```kconfig
config BR2_PACKAGE_TIMIDITY
	bool "timidity"
	help
	  TiMidity is a MIDI to WAVE converter that uses Gravis
	  Ultrasound(*)-compatible patch files to generate digital audio data
	  from General MIDI files. The audio data can be played through any
	  sound device or stored on disk. On a fast machine, music can be
	  played in real time. TiMidity runs under Linux, FreeBSD, HP-UX, SunOS, and
	  Win32, and porting to other systems with gcc should be easy.

	  https://sourceforge.net/projects/libtimidity/
```

## package/retrolx/linux/kernel-s812/Config.in
```kconfig
config BR2_PACKAGE_KERNEL_S812
        bool "kernel-s812"
        help
          Amlogic S812 (Meson8) kernel for RetroLX
```

## package/retrolx/ports/cannonball/Config.in
```kconfig
config BR2_PACKAGE_CANNONBALL
	bool "cannonball"
	depends on BR2_INSTALL_LIBSTDCPP
	depends on BR2_PACKAGE_SDL2
	depends on BR2_PACKAGE_BOOST
	help
	  Cannonball - OutRun Engine

	  https://github.com/djyt/cannonball

comment "Cannonball needs a toolchain w/ C++, and following libraries : sdl2, boost"
	depends on !BR2_INSTALL_LIBSTDCPP || !BR2_PACKAGE_SDL2 || !BR2_PACKAGE_BOOST
```

## package/retrolx/ports/cdogs/Config.in
```kconfig
config BR2_PACKAGE_CDOGS
	bool "cdogs"
	depends on BR2_PACKAGE_SDL2
	depends on BR2_PACKAGE_PYTHON_PROTOBUF
	depends on BR2_INSTALL_LIBSTDCPP
	help
	  Classic overhead run-and-gun game

	  https://cxong.github.io/cdogs-sdl/

comment "BR2_PACKAGE_CDOGS needs a toolchain w/ C++"
	depends on !BR2_INSTALL_LIBSTDCPP
```

## package/retrolx/ports/cgenius/Config.in
```kconfig
config BR2_PACKAGE_CGENIUS
	bool "cgenius"
	depends on BR2_PACKAGE_SDL2
	depends on BR2_PACKAGE_SDL2_IMAGE
	depends on BR2_PACKAGE_SDL2_TTF
	depends on BR2_PACKAGE_SDL2_MIXER
	depends on BR2_PACKAGE_BOOST
	help
	  Commander Genius - Commander Keen Engine
	  
	  https://github.com/gerstrong/Commander-Genius
```

## package/retrolx/ports/corsixth/Config.in
```kconfig
config BR2_PACKAGE_CORSIXTH
	bool "corsixth"
	depends on BR2_PACKAGE_SDL2
	depends on BR2_PACKAGE_SDL2_IMAGE

	help
	  CorsixTH - Theme Hospital engine

	  https://github.com/CorsixTH/CorsixTH
```

## package/retrolx/ports/devilutionx/Config.in
```kconfig
config BR2_PACKAGE_DEVILUTIONX
	bool "DevilutionX"
	depends on BR2_PACKAGE_BZIP2
	depends on BR2_PACKAGE_SDL2
	depends on BR2_PACKAGE_SDL2_IMAGE
	depends on BR2_PACKAGE_FMT
	depends on BR2_PACKAGE_LIBSODIUM
	help
	  Diablo 1.

	  https://github.com/diasurgical/devilutionX/
```

## package/retrolx/ports/ecwolf/Config.in
```kconfig
config BR2_PACKAGE_ECWOLF
    depends on BR2_PACKAGE_SDL2
    depends on BR2_PACKAGE_SDL2_NET
    depends on BR2_PACKAGE_SDL2_MIXER
    depends on BR2_PACKAGE_LIBJPEG
    depends on BR2_PACKAGE_FLUIDSYNTH
    depends on BR2_PACKAGE_LIBMODPLUG
    depends on BR2_PACKAGE_OPUSFILE
    depends on BR2_PACKAGE_FLAC
    depends on BR2_PACKAGE_LIBVORBIS
    bool "ecwolf"
    help
      ECWolf is a port of the Wolfenstein 3D engine based of Wolf4SDL.

	    http://maniacsvault.net/ecwolf/
```

## package/retrolx/ports/vcmi/Config.in
```kconfig
config BR2_PACKAGE_VCMI
	bool "vcmi"
	depends on BR2_PACKAGE_SDL2
	depends on BR2_PACKAGE_SDL2_IMAGE
	depends on BR2_PACKAGE_SDL2_MIXER
	depends on BR2_PACKAGE_SDL2_TTF
	depends on BR2_PACKAGE_FFMPEG
	depends on BR2_PACKAGE_TBB

	help
	  Heroes of Might and Magic 3 engine.

	  https://vcmi.eu
```

## package/retrolx/ports/xash3d/Config.in
```kconfig
config BR2_PACKAGE_XASH3D
        bool "xash3d"
        depends on BR2_PACKAGE_SDL2
        depends on BR2_PACKAGE_SDL2_IMAGE
        depends on BR2_PACKAGE_SDL2_TTF
        depends on BR2_PACKAGE_SDL2_MIXER
        depends on BR2_PACKAGE_FREETYPE
        depends on BR2_PACKAGE_FONTCONFIG
        depends on BR2_PACKAGE_LIBSODIUM
        depends on BR2_INSTALL_LIBSTDCPP

        select BR2_PACKAGE_XASH3D_FWGS
        select BR2_PACKAGE_HLSDK_XASH3D
        # Xash3D requires additional client and/or server libraries for some games.
        # Below are the packages for these libraries
        # See https://github.com/FWGS/xash3d-fwgs/blob/master/Documentation/supported-mod-list.md#list-of-games-and-mods-with-custom-gamedll
        select BR2_PACKAGE_HLSDK_XASH3D_DMC
        select BR2_PACKAGE_HLSDK_XASH3D_OPFOR
```

## package/retrolx/ports/xash3d/xash3d-fwgs/Config.in
```kconfig
config BR2_PACKAGE_XASH3D_FWGS
	bool "Xash3D-FWGS Half-Life Engine"
	depends on BR2_PACKAGE_SDL2
	depends on BR2_PACKAGE_SDL2_IMAGE
	depends on BR2_PACKAGE_SDL2_TTF
	depends on BR2_PACKAGE_SDL2_MIXER
	depends on BR2_PACKAGE_FREETYPE
	depends on BR2_PACKAGE_FONTCONFIG
	depends on BR2_INSTALL_LIBSTDCPP
	help
	  Half-Life 1 Engine.

	  https://github.com/FWGS/xash3d-fwgs
```

## package/retrolx/utils/gpicase2/Config.in
```kconfig
config BR2_PACKAGE_GPICASE2
        bool "gpicase2"
	#depends on BR2_PACKAGE_RPI_USERLAND

comment "gpicase2"
	#depends on BR2_PACKAGE_RPI_USERLAND
```

## package/retrolx/utils/mangohud/Config.in
```kconfig
config BR2_PACKAGE_MANGOHUD
	bool "mangohud"
	depends on BR2_PACKAGE_LIBDRM
        depends on BR2_PACKAGE_XORG7
	depends on BR2_PACKAGE_VULKAN_HEADERS
	depends on BR2_PACKAGE_GLSLANG
	
	help
	  Command line tool for injecting HUD / overlay in GL/Vulkan apps

          https://github.com/flightlessmango/MangoHud
```

## package/retrolx/utils/xow/Config.in
```kconfig
config BR2_PACKAGE_XOW
	bool "xow"
	depends on BR2_PACKAGE_LIBUSB

	help
	  xbox receiver daemon
```
