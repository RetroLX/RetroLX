## package/retrolx/frontends/retroarch/retrolx-bezel/Config.in
```kconfig
config BR2_PACKAGE_RETROLX_BEZEL
        bool "retrolx bezel"
        help
          Batocera bezel

	  https://github.com/batocera-linux/batocera-bezel
```

## package/retrolx/frontends/retroarch/shaders/retrolx-shaders/Config.in
```kconfig
config BR2_PACKAGE_RETROLX_SHADERS
        bool "retrolx shaders"
	depends on BR2_PACKAGE_RETROARCH
        select BR2_PACKAGE_GLSL_SHADERS
        help
          Batocera shaders for retroarch
```

## package/retrolx/frontends/retrofe/Config.in
```kconfig
config BR2_PACKAGE_RETROFE
    bool "retrofe"
    depends on BR2_PACKAGE_SDL2
    depends on BR2_PACKAGE_SDL2_IMAGE
    depends on BR2_PACKAGE_SDL2_MIXER
    depends on BR2_PACKAGE_SDL2_TTF
    depends on BR2_PACKAGE_GSTREAMER1
    depends on BR2_PACKAGE_GST1_PLUGINS_BASE

    help
      RetroFE frontend

      https://github.com/phulshof/RetroFE
```

## package/retrolx/frontends/retrolx-launcher/Config.in
```kconfig
config BR2_PACKAGE_RETROLX_LAUNCHER
    bool "retrolx-launcher"

    depends on BR2_PACKAGE_SDL2
    depends on BR2_PACKAGE_RETROLX_QT

    help
      RetroLX launcher / system manager

      https://github.com/RetroLX/launcher
```

## package/retrolx/frontends/retrolx-retroarch/retrolx-retroachievements-sounds/Config.in
```kconfig
config BR2_PACKAGE_RETROLX_RETROACHIEVEMENTS_SOUNDS
        bool "retrolx retroachievements sounds"
        help
          Play a sound when a retroachievement is unlocked
```

## package/retrolx/gpu/vulkan/spirv-tools/Config.in
```kconfig
config BR2_PACKAGE_SPIRV_TOOLS
	bool "spirv-tools"
	help
	  SPIR-V Tools
	  https://github.com/KhronosGroup/SPIRV-Tools
```

## package/retrolx/kernel/Config.in
```kconfig
config BR2_PACKAGE_RETROLX_KERNEL
        bool "retrolx-kernel"
        help
          Linux kernel for RetroLX
```

## package/retrolx/kernels/kernel-aw32/Config.in
```kconfig
config BR2_PACKAGE_RETROLX_KERNEL_AW32
        bool "retrolx-kernel-aw32"
        help
          Allwinner 32-bit Linux kernel for RetroLX
```

## package/retrolx/kernels/kernel-h616/Config.in
```kconfig
config BR2_PACKAGE_RETROLX_KERNEL_H616
        bool "retrolx-kernel-h616"
        help
          Allwinner H616 Linux kernel for RetroLX
```

## package/retrolx/kernels/kernel-odroidxu4/Config.in
```kconfig
config BR2_PACKAGE_RETROLX_KERNEL_ODROIDXU4
        bool "retrolx-kernel-odroidxu4"
        help
          HardKernel ODROID-XU3/4 (Samsung Exynos 5422) Linux kernel for RetroLX
```

## package/retrolx/kernels/kernel-rk3288/Config.in
```kconfig
config BR2_PACKAGE_RETROLX_KERNEL_RK3288
        bool "retrolx-kernel-rk3288"
        help
          Rockchip RK3288 Linux kernel for RetroLX
```

## package/retrolx/kernels/kernel-rk3326/Config.in
```kconfig
config BR2_PACKAGE_RETROLX_KERNEL_RK3326
        bool "retrolx-kernel-rk3326"
        help
          Rockchip RK3326 Linux kernel for RetroLX
```

## package/retrolx/kernels/kernel-rk3328/Config.in
```kconfig
config BR2_PACKAGE_RETROLX_KERNEL_RK3328
        bool "retrolx-kernel-rk3328"
        help
          Rockchip RK3328 Linux kernel for RetroLX
```

## package/retrolx/kernels/kernel-s812/Config.in
```kconfig
config BR2_PACKAGE_RETROLX_KERNEL_S812
        bool "retrolx-kernel-s812"
        help
          Amlogic S812 Linux kernel for RetroLX
```

## package/retrolx/kernels/retrolx-kernel-i686/Config.in
```kconfig
config BR2_PACKAGE_RETROLX_KERNEL_I686
        bool "retrolx-kernel-i686"
        help
          Generic i686 Linux kernel for RetroLX
```

## package/retrolx/kernels/retrolx-kernel-meson64/Config.in
```kconfig
config BR2_PACKAGE_RETROLX_KERNEL_MESON64
        bool "retrolx-kernel-meson64"
        help
          Amlogic AArch64 (Cortex-A53) Linux kernel for RetroLX
```

## package/retrolx/kernels/retrolx-kernel-ps4/Config.in
```kconfig
config BR2_PACKAGE_RETROLX_KERNEL_PS4
        bool "retrolx-kernel-ps4"
        help
          PS4 Linux kernel for RetroLX
```

## package/retrolx/kernels/retrolx-kernel-rk3128/Config.in
```kconfig
config BR2_PACKAGE_RETROLX_KERNEL_RK3128
        bool "retrolx-kernel-rk3128"
        help
          Rockchip RK3128 Linux kernel for RetroLX
```

## package/retrolx/kernels/retrolx-kernel-rk3399/Config.in
```kconfig
config BR2_PACKAGE_RETROLX_KERNEL_RK3399
        bool "retrolx-kernel-rk3399"
        help
          Rockchip RK3399 Linux kernel for RetroLX
```

## package/retrolx/kernels/retrolx-kernel-rk356x/Config.in
```kconfig
config BR2_PACKAGE_RETROLX_KERNEL_RK356X
        bool "retrolx-kernel-rk356x"
        help
          Rockchip RK356x Linux kernel for RetroLX
```

## package/retrolx/kernels/retrolx-kernel-rpi1/Config.in
```kconfig
config BR2_PACKAGE_RETROLX_KERNEL_RPI1
        bool "retrolx-kernel-rpi1"
        help
          Raspberry Pi 1 / Zero Linux kernel for RetroLX
```

## package/retrolx/kernels/retrolx-kernel-rpi2/Config.in
```kconfig
config BR2_PACKAGE_RETROLX_KERNEL_RPI2
        bool "retrolx-kernel-rpi2"
        help
          Raspberry Pi 2 Linux kernel for RetroLX
```

## package/retrolx/kernels/retrolx-kernel-rpi3/Config.in
```kconfig
config BR2_PACKAGE_RETROLX_KERNEL_RPI3
        bool "retrolx-kernel-rpi3"
        help
          Raspberry Pi 3 / CM3 / Zero 2 Linux kernel for RetroLX
```

## package/retrolx/kernels/retrolx-kernel-rpi4/Config.in
```kconfig
config BR2_PACKAGE_RETROLX_KERNEL_RPI4
        bool "retrolx-kernel-rpi4"
        help
          Raspberry Pi 4 / CM4 / 400 Linux kernel for RetroLX
```

## package/retrolx/kernels/retrolx-kernel-s905gen3/Config.in
```kconfig
config BR2_PACKAGE_RETROLX_KERNEL_S905GEN3
        bool "retrolx-kernel-s905gen3"
        help
          Amlogic S905X3/S905Y3/S905D3 Linux kernel for RetroLX
```
