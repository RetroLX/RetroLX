## package/retrolx/emulators/libretro/libretro-xmil/Config.in
```kconfig
config BR2_PACKAGE_LIBRETRO_XMIL
        bool "libretro-xmil"
	depends on BR2_INSTALL_LIBSTDCPP
        help
          A libretro Sharp X1 emulator
```

## package/retrolx/emulators/mame/Config.in
```kconfig
config BR2_PACKAGE_MAME
	bool "mame"
        depends on BR2_INSTALL_LIBSTDCPP
        depends on BR2_PACKAGE_SDL2
        depends on BR2_PACKAGE_SDL2_TTF
	depends on BR2_PACKAGE_ZLIB
        depends on BR2_PACKAGE_LIBPNG
	depends on BR2_PACKAGE_JPEG
        depends on BR2_PACKAGE_SQLITE
	depends on BR2_PACKAGE_FONTCONFIG
	depends on BR2_PACKAGE_RAPIDJSON
	depends on BR2_PACKAGE_EXPAT
	depends on BR2_PACKAGE_GLM

	help
	  MAME emulator standalone package

	  https://mamedev.org
```

## package/retrolx/emulators/mednafen/Config.in
```kconfig
config BR2_PACKAGE_MEDNAFEN
    bool "mednafen"
    depends on BR2_PACKAGE_SDL2
    depends on BR2_PACKAGE_ZLIB
    depends on BR2_PACKAGE_LIBPNG

    help
        Mednafen is a portable, utilizing OpenGL and SDL, argument(command-line)-driven multi-system emulator.
```

## package/retrolx/emulators/melonds/Config.in
```kconfig
config BR2_PACKAGE_MELONDS
    bool "melonDS"
    depends on BR2_PACKAGE_SDL2
    depends on BR2_PACKAGE_SLIRP
    depends on BR2_PACKAGE_RETROLX_QT5
    help
      Ninteno DS emulator, sorta
      http://melonds.kuribo64.net/
```

## package/retrolx/emulators/mupen64plus/Config.in
```kconfig
config BR2_PACKAGE_MUPEN64PLUS
	bool "mupen64plus"

	# Core module
	select BR2_PACKAGE_MUPEN64PLUS_CORE

	# Console (command-line) front-end user interface
	select BR2_PACKAGE_MUPEN64PLUS_UICONSOLE

	# Input plugin
	select BR2_PACKAGE_MUPEN64PLUS_INPUT_SDL

	# RSP processor plugin
	select BR2_PACKAGE_MUPEN64PLUS_RSPHLE

	# Audio plugin
	select BR2_PACKAGE_MUPEN64PLUS_AUDIO_SDL           if  !BR2_PACKAGE_RETROLX_TARGET_RPI2
	select BR2_PACKAGE_MUPEN64PLUS_OMX                 if  BR2_PACKAGE_RETROLX_TARGET_RPI2 # rpi audio

	# Video plugins
	select BR2_PACKAGE_MUPEN64PLUS_GLIDEN64             if !BR2_PACKAGE_RETROLX_RPI_VCORE && !BR2_PACKAGE_RETROLX_LIMA_MESA3D
	#select BR2_PACKAGE_MUPEN64PLUS_VIDEO_GLIDE64MK2     if !BR2_PACKAGE_RETROLX_RPI_VCORE && !BR2_PACKAGE_RETROLX_LIMA_MESA3D
	select BR2_PACKAGE_MUPEN64PLUS_GLES2                if !BR2_aarch64 && (BR2_PACKAGE_RETROLX_RPI_VCORE || BR2_PACKAGE_RETROLX_LIMA_MESA3D)
	select BR2_PACKAGE_MUPEN64PLUS_VIDEO_RICE           if BR2_PACKAGE_RETROLX_IS_X86_ARCH || BR2_PACKAGE_RETROLX_PANFROST_MESA3D || BR2_PACKAGE_RETROLX_TARGET_RPI4

	help
	  Mupen64
```

## package/retrolx/emulators/mupen64plus/mupen64plus-video-rice/Config.in
```kconfig
config BR2_PACKAGE_MUPEN64PLUS_VIDEO_RICE
        bool "mupen64plus-video-rice"
	depends on BR2_INSTALL_LIBSTDCPP
	depends on BR2_PACKAGE_SDL2
	depends on BR2_PACKAGE_ALSA_LIB
	depends on BR2_PACKAGE_BOOST
	depends on BR2_PACKAGE_BOOST_FILESYSTEM
        help
          mupen 64 plus video-rice module
	  https://github.com/mupen64plus/

comment "MUPEN64PLUS VIDEO_RICE needs a toolchain w/ C++, ALSA and SDL2"
	depends on !BR2_INSTALL_LIBSTDCPP || !BR2_PACKAGE_SDL2 || !BR2_PACKAGE_ALSA_LIB
```

## package/retrolx/emulators/openbor/Config.in
```kconfig
config BR2_PACKAGE_OPENBOR
        bool "openbor"
	select BR2_PACKAGE_OPENBOR4432
	select BR2_PACKAGE_OPENBOR6330
	select BR2_PACKAGE_OPENBOR6412
	select BR2_PACKAGE_OPENBOR6510
```

## package/retrolx/emulators/openbor/openbor6330/Config.in
```kconfig
config BR2_PACKAGE_OPENBOR6330
        bool "openbor6330"
	depends on BR2_PACKAGE_LIBVPX
	depends on BR2_PACKAGE_SDL2
	depends on BR2_PACKAGE_SDL2_GFX
	depends on BR2_PACKAGE_LIBPNG
	depends on BR2_PACKAGE_LIBOGG
	depends on BR2_PACKAGE_LIBVORBIS
```

## package/retrolx/emulators/openbor/openbor6510/Config.in
```kconfig
config BR2_PACKAGE_OPENBOR6510
        bool "openbor6510"
	depends on BR2_PACKAGE_LIBVPX
	depends on BR2_PACKAGE_SDL2
	depends on BR2_PACKAGE_SDL2_GFX
	depends on BR2_PACKAGE_LIBPNG
	depends on BR2_PACKAGE_LIBOGG
	depends on BR2_PACKAGE_LIBVORBIS
```

## package/retrolx/emulators/pcsx2/Config.in
```kconfig
config BR2_PACKAGE_PCSX2
        bool "pcsx2"
	depends on BR2_x86_64
	depends on BR2_PACKAGE_XORG7
	depends on BR2_PACKAGE_FMT
	depends on BR2_PACKAGE_ALSA_LIB
	depends on BR2_PACKAGE_FREETYPE
	depends on BR2_PACKAGE_ZLIB
	depends on BR2_PACKAGE_LIBPNG
	depends on BR2_PACKAGE_WXWIDGETS
	depends on BR2_PACKAGE_LIBAIO
	depends on BR2_PACKAGE_PORTAUDIO
	depends on BR2_PACKAGE_LIBSOUNDTOUCH
	depends on BR2_PACKAGE_LIBSAMPLERATE
	depends on BR2_PACKAGE_SDL2
	depends on BR2_PACKAGE_DEJAVU
	depends on BR2_PACKAGE_LIBPCAP
	depends on BR2_PACKAGE_YAML_CPP
	depends on BR2_PACKAGE_LIBGTK3
        help
          A  pcsx2 emulator
```

## package/retrolx/emulators/play/Config.in
```kconfig
config BR2_PACKAGE_PLAY
        bool "play"
	depends on BR2_PACKAGE_XORG7
	depends on BR2_PACKAGE_QT5BASE
	depends on BR2_PACKAGE_QT5X11EXTRAS
	depends on BR2_PACKAGE_LIBGLEW

        help
          A PS2 portable emulator
```

## package/retrolx/emulators/ppsspp/Config.in
```kconfig
config BR2_PACKAGE_PPSSPP
	bool "ppsspp"
	depends on BR2_PACKAGE_SDL2
	depends on BR2_PACKAGE_LIBZIP
	help
	  A  PSP emulator
```

## package/retrolx/emulators/rpcs3/Config.in
```kconfig
config BR2_PACKAGE_RPCS3
        bool "rpcs3"
	depends on BR2_TOOLCHAIN_GCC_AT_LEAST_10
	depends on BR2_PACKAGE_RETROLX_QT
	depends on BR2_PACKAGE_MESA3D
	depends on BR2_PACKAGE_LIBGLEW
	depends on BR2_PACKAGE_LIBGLU
	depends on BR2_PACKAGE_FFMPEG_SWSCALE
	depends on BR2_PACKAGE_NCURSES
	depends on BR2_PACKAGE_LIBXML2
	depends on BR2_PACKAGE_LIBUSB
	depends on BR2_PACKAGE_LIBEVDEV
	depends on BR2_PACKAGE_OPENAL
	depends on BR2_PACKAGE_ALSA_LIB
	depends on BR2_PACKAGE_FAUDIO
	depends on BR2_PACKAGE_WOLFSSL
        help
          A PS3 emulator
```

## package/retrolx/emulators/scummvm/Config.in
```kconfig
config BR2_PACKAGE_SCUMMVM
        bool "Scummvm"
	depends on BR2_INSTALL_LIBSTDCPP
	depends on BR2_PACKAGE_SDL2
	depends on BR2_PACKAGE_LIBMPEG2
	depends on BR2_PACKAGE_JPEG
	depends on BR2_PACKAGE_LIBOGG
        depends on BR2_PACKAGE_LIBVORBIS
        depends on BR2_PACKAGE_FLAC
        depends on BR2_PACKAGE_LIBMAD
        depends on BR2_PACKAGE_LIBPNG
        depends on BR2_PACKAGE_LIBTHEORA
        depends on BR2_PACKAGE_FAAD2
        depends on BR2_PACKAGE_FREETYPE
	depends on BR2_PACKAGE_ZLIB  

        help
		ScummVM point and click 
		http://wiki.scummvm.org/

comment "Scummvm  needs a toolchain w/ C++,  SDL2"
	depends on !BR2_INSTALL_LIBSTDCPP || !BR2_PACKAGE_SDL2
```

## package/retrolx/emulators/simcoupe/Config.in
```kconfig
config BR2_PACKAGE_SIMCOUPE
    bool "simcoupe"
    depends on BR2_PACKAGE_SDL2
    depends on BR2_PACKAGE_ZLIB
    depends on BR2_PACKAGE_LIBPNG
    depends on BR2_PACKAGE_LIBCAPSIMAGE

    help
        SimCoupe emulates the SAM Coupé - a British Z80-based home computer released in 1989 by Miles Gordon Technology.
```

## package/retrolx/emulators/supermodel/Config.in
```kconfig
config BR2_PACKAGE_SUPERMODEL
        bool "supermodel"
        depends on BR2_x86_64 # not really, it rather depends on full OpenGL
        depends on BR2_INSTALL_LIBSTDCPP
        depends on BR2_PACKAGE_LIBZIP
        depends on BR2_PACKAGE_SDL2
        depends on BR2_PACKAGE_SDL2_NET
        select BR2_PACKAGE_LIBGLEW if BR2_PACKAGE_RETROLX_IS_X86_ARCH

        help
          Supermodel is a SEGA Model 3 emulator that uses the SDL-Library.

	  http://www.supermodel3.com
	  source: https://sourceforge.net/p/model3emu/

comment "SUPERMODEL needs a toolchain w/ C++"
	depends on !BR2_INSTALL_LIBSTDCPP
```

## package/retrolx/emulators/tsugaru/Config.in
```kconfig
config BR2_PACKAGE_TSUGARU
    bool "tsugaru"
    depends on BR2_PACKAGE_LIBGLU
    help
      FM TOWNS Emulator "Tsugaru"

	    https://github.com/captainys/TOWNSEMU
```

## package/retrolx/emulators/xenia/Config.in
```kconfig
config BR2_PACKAGE_XENIA
    bool "xenia"
    depends on BR2_x86_64

    help
      Experimental Xbox 360 emulator

	    https://xenia.jp/
```

## package/retrolx/emulators/yuzu/Config.in
```kconfig
config BR2_PACKAGE_YUZU
    bool "yuzu"
    depends on BR2_x86_64
    depends on BR2_PACKAGE_XORG7
    depends on BR2_PACKAGE_JSON_FOR_MODERN_CPP
    depends on BR2_PACKAGE_RETROLX_QT
    depends on BR2_PACKAGE_SDL2
    depends on BR2_PACKAGE_FMT
    depends on BR2_PACKAGE_BOOST
    depends on BR2_PACKAGE_FFMPEG  
    depends on BR2_PACKAGE_ZSTD
    depends on BR2_PACKAGE_ZLIB
    depends on BR2_PACKAGE_LIBZIP
    depends on BR2_PACKAGE_LZ4
    depends on BR2_PACKAGE_OPUS
    help
      A Emulator Yuzu core for Nintendo Switch.

	    https://yuzu-emu.org/
```

## package/retrolx/frontends/emulationstation/es-theme-carbon/Config.in
```kconfig
config BR2_PACKAGE_ES_THEME_CARBON
	bool "es-theme-carbon"
	help
	  https://github.com/fabricecaruso/es-theme-carbon
```

## package/retrolx/frontends/emulationstation/es-theme-minijawn/Config.in
```kconfig
config BR2_PACKAGE_ES_THEME_MINIJAWN
	bool "es-theme-minijawn"
	help
	  https://github.com/pacdude/es-theme-minijawn
```

## package/retrolx/frontends/emulationstation/retrolx-emulationstation/Config.in
```kconfig
config BR2_PACKAGE_RETROLX_EMULATIONSTATION
        bool "retrolx-emulationstation"
	depends on BR2_INSTALL_LIBSTDCPP
	depends on BR2_PACKAGE_SDL2
	depends on BR2_PACKAGE_SDL2_MIXER
	depends on BR2_PACKAGE_ALSA_LIB
	depends on BR2_PACKAGE_ALSA_UTILS_AMIXER
	depends on (BR2_PACKAGE_HAS_LIBGLES || BR2_PACKAGE_HAS_LIBGL)
	depends on BR2_PACKAGE_FREETYPE
	depends on BR2_PACKAGE_DEJAVU
	depends on BR2_PACKAGE_GETTEXT
	depends on BR2_PACKAGE_OPENSSL
	depends on BR2_PACKAGE_LIBCURL
	depends on BR2_PACKAGE_NANUM_FONT
	depends on BR2_PACKAGE_FPING
	depends on BR2_PACKAGE_GSTREAMER1
	#depends on BR2_PACKAGE_VLC
	depends on BR2_PACKAGE_RAPIDJSON
	depends on BR2_PACKAGE_POPPLER
	depends on BR2_PACKAGE_POPPLER_UTILS
        help
          A multi emulator frontend.

	  https://github.com/RetroLX/EmulationStation

comment "Emulation station 2 needs a toolchain w/ C++"
```

## package/retrolx/frontends/emulationstation/retrolx-es-system/Config.in
```kconfig
config BR2_PACKAGE_RETROLX_ES_SYSTEM
        bool "retrolx-es-system"
        select BR2_PACKAGE_RETROLX_EMULATIONSTATION
        select BR2_PACKAGE_ES_THEME_CARBON
        select BR2_PACKAGE_ES_THEME_MINIJAWN
        select BR2_PACKAGE_ES_BACKGROUND_MUSICS
        select BR2_PACKAGE_RETROLX_CONFIGGEN

        help
          EmulationStation + configgen glue
	  Generates the es_system.cfg file and the roms folder
```

## package/retrolx/frontends/pegasus/Config.in
```kconfig
config BR2_PACKAGE_PEGASUS
    bool "pegasus"
    depends on BR2_PACKAGE_SDL2
    depends on BR2_PACKAGE_RETROLX_QT5

    help
      Pegasus frontend

      https://github.com/mmatyas/pegasus-frontend
```

## package/retrolx/frontends/retroarch/batocera-retroachievements-sounds/Config.in
```kconfig
config BR2_PACKAGE_RETROLX_RETROACHIEVEMENTS_SOUNDS
        bool "batocera retroachievements sounds"
        help
          Play a sound when a retroachievement is unlocked
```
