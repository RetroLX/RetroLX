## package/retrolx/emulators/citra/Config.in
```kconfig
config BR2_PACKAGE_CITRA
    bool "citra"
    depends on BR2_PACKAGE_FMT
    depends on BR2_PACKAGE_BOOST
    depends on BR2_PACKAGE_FDK_AAC
    depends on BR2_PACKAGE_SDL2
    help
      A Emulator Citra core for Nintendo 3DS.

	    https://citra-emu.org/
```

## package/retrolx/emulators/daphne/Config.in
```kconfig
config BR2_PACKAGE_DAPHNE
    bool "daphne"
    depends on BR2_PACKAGE_SDL2
    depends on BR2_PACKAGE_SDL2_IMAGE
    depends on BR2_PACKAGE_SDL2_TTF
    depends on BR2_PACKAGE_ZLIB
    depends on BR2_PACKAGE_LIBOGG
    depends on BR2_PACKAGE_LIBVORBIS	  
    depends on BR2_PACKAGE_LIBMPEG2
  
    help
      Hypseus is a fork of Daphne. A program that 
      "lets one play the original versions of many 
      laserdisc arcade games on one's PC."

      https://github.com/btolab/hypseus
```

## package/retrolx/emulators/dolphin-emu/Config.in
```kconfig
config BR2_PACKAGE_DOLPHIN_EMU
	bool "dolphin-emu"
	depends on BR2_x86_64 || BR2_aarch64
	depends on BR2_PACKAGE_LIBEVDEV
	depends on BR2_PACKAGE_FFMPEG
	depends on BR2_PACKAGE_ZLIB
	depends on BR2_PACKAGE_XZ
	depends on BR2_PACKAGE_LIBPNG
	depends on BR2_PACKAGE_LZO
	depends on BR2_PACKAGE_LIBUSB
	depends on BR2_PACKAGE_LIBCURL
	depends on BR2_PACKAGE_BLUEZ5_UTILS
	depends on BR2_PACKAGE_HIDAPI
	depends on BR2_PACKAGE_QT5
	depends on BR2_PACKAGE_QT5BASE
	depends on BR2_PACKAGE_QT5BASE_OPENGL
	depends on BR2_PACKAGE_QT5BASE_FONTCONFIG
	depends on BR2_PACKAGE_QT5BASE_GUI
	depends on BR2_PACKAGE_QT5BASE_WIDGETS
	depends on BR2_PACKAGE_QT5BASE_GIF
	depends on BR2_PACKAGE_QT5BASE_JPEG
	depends on BR2_PACKAGE_QT5BASE_PNG
	help
	  Gamecube/Wii emulator

	comment "DOLPHIN_EMU needs a toolchain w/ C++, OpenGL"
	depends on !BR2_INSTALL_LIBSTDCPP || !BR2_PACKAGE_HAS_LIBGL
```

## package/retrolx/emulators/dosbox-staging/Config.in
```kconfig
config BR2_PACKAGE_DOSBOX_STAGING
	bool "dosbox-staging"
	depends on BR2_INSTALL_LIBSTDCPP
	depends on BR2_PACKAGE_SDL2
	depends on BR2_PACKAGE_SDL2_NET
	depends on BR2_PACKAGE_ZLIB
	depends on BR2_PACKAGE_LIBPNG
	depends on BR2_PACKAGE_LIBOGG
	depends on BR2_PACKAGE_LIBVORBIS      
	depends on BR2_PACKAGE_OPUS
	depends on BR2_PACKAGE_OPUSFILE
	depends on BR2_PACKAGE_LIBCURL
	depends on BR2_PACKAGE_HOST_PYTHON3
	depends on BR2_PACKAGE_HOST_PYTHON3_SSL
	depends on BR2_PACKAGE_FLUIDSYNTH

	help
	  Modernized DOSBox soft-fork

	  https://github.com/dosbox-staging/dosbox-staging
```

## package/retrolx/emulators/dosbox-x/Config.in
```kconfig
config BR2_PACKAGE_DOSBOX_X
	bool "dosbox-x"
        depends on BR2_INSTALL_LIBSTDCPP
        depends on BR2_PACKAGE_SDL2
        depends on BR2_PACKAGE_SDL2_NET
        depends on BR2_PACKAGE_SDL_SOUND
        depends on BR2_PACKAGE_ZLIB
        depends on BR2_PACKAGE_LIBPNG
        depends on BR2_PACKAGE_LIBOGG
        depends on BR2_PACKAGE_LIBVORBIS      
        depends on BR2_PACKAGE_FFMPEG
        depends on BR2_PACKAGE_FFMPEG_AVRESAMPLE
        depends on BR2_PACKAGE_FFMPEG_SWSCALE

	help
	  DOSBox is a DOS-emulator that uses the SDL-library 
          which makes DOSBox very easy to port to different platforms

	  https://github.com/joncampbell123/dosbox-x
```

## package/retrolx/emulators/dosbox/Config.in
```kconfig
config BR2_PACKAGE_DOSBOX
	bool "dosbox"
        depends on BR2_INSTALL_LIBSTDCPP
        depends on BR2_PACKAGE_SDL2
	depends on BR2_PACKAGE_SDL2_NET
	depends on BR2_PACKAGE_SDL_SOUND
	depends on BR2_PACKAGE_ZLIB
        depends on BR2_PACKAGE_LIBPNG
        depends on BR2_PACKAGE_LIBOGG
        depends on BR2_PACKAGE_LIBVORBIS

	help
	  DOSBox is a DOS-emulator that uses the SDL-library 
          which makes DOSBox very easy to port to different platforms

	  https://github.com/duganchen/dosbox
```

## package/retrolx/emulators/drastic/Config.in
```kconfig
config BR2_PACKAGE_DRASTIC
	bool "drastic"
	help
          Drastic is a closed-source Nintedo DS emulator.

          https://www.drastic-ds.com/
```

## package/retrolx/emulators/duckstation/Config.in
```kconfig
config BR2_PACKAGE_DUCKSTATION
    bool "duckstation"
    depends on BR2_PACKAGE_FMT
    depends on BR2_PACKAGE_RETROLX_BOOST
    depends on BR2_PACKAGE_FFMPEG  
    depends on BR2_PACKAGE_SDL2
    depends on BR2_PACKAGE_LIBEVDEV
    depends on BR2_PACKAGE_LIBDRM
    depends on BR2_PACKAGE_ECM
    help
      DuckStation - PlayStation 1, aka. PSX Emulator

	    https://github.com/stenzek/duckstation
```

## package/retrolx/emulators/easyrpg/easyrpg-player/Config.in
```kconfig
config BR2_PACKAGE_EASYRPG_PLAYER
    bool "easyrpg-player"
    select BR2_PACKAGE_LIBLCF
    depends on BR2_PACKAGE_SDL2
    depends on BR2_PACKAGE_SDL2_MIXER
    depends on BR2_PACKAGE_LIBPNG
    depends on BR2_PACKAGE_ZLIB
    depends on BR2_PACKAGE_FMT
    depends on BR2_PACKAGE_FREETYPE
    depends on BR2_PACKAGE_MPG123
    depends on BR2_PACKAGE_LIBVORBIS
    depends on BR2_PACKAGE_OPUSFILE
    depends on BR2_PACKAGE_PIXMAN
    depends on BR2_PACKAGE_SPEEXDSP
    depends on BR2_PACKAGE_LIBXMP
    depends on BR2_PACKAGE_WILDMIDI
    help
      EasyRPG Player is a game interpreter to play RPG Maker 2000, 2003 and EasyRPG games. It uses the LCF parser library (liblcf) to read RPG Maker game data.

      EasyRPG Player is part of the EasyRPG Project. More information is available at the project website: https://easyrpg.org/
```

## package/retrolx/emulators/flash/ruffle/Config.in
```kconfig
config BR2_PACKAGE_RUFFLE
	bool "ruffle"
	depends on BR2_PACKAGE_HOST_RUSTC
	depends on BR2_PACKAGE_OPENSSL

	help
          Ruffle
          Flash emulator for windows / mac / linux.

          https://ruffle.rs/
```

## package/retrolx/emulators/fsuae/Config.in
```kconfig
config BR2_PACKAGE_FSUAE
        bool "fs-uae"
	depends on BR2_PACKAGE_LIBGLIB2
	depends on BR2_PACKAGE_OPENAL
	depends on BR2_PACKAGE_LIBPNG
	depends on BR2_PACKAGE_SDL2
	depends on BR2_PACKAGE_ZLIB
	depends on BR2_PACKAGE_LIBMPEG2
	depends on BR2_PACKAGE_LIBCAPSIMAGE
        help
          A crossplatform amiga emulator
```

## package/retrolx/emulators/gsplus/Config.in
```kconfig
config BR2_PACKAGE_GSPLUS
    bool "gsplus"
    depends on BR2_PACKAGE_SDL2
    depends on BR2_PACKAGE_LIBPCAP

    help
    	An Apple ][ GS emulator
```

## package/retrolx/emulators/hatari/Config.in
```kconfig
config BR2_PACKAGE_HATARI
    bool "hatari"
    depends on BR2_PACKAGE_SDL2
    depends on BR2_PACKAGE_ZLIB
    depends on BR2_PACKAGE_LIBPNG
    depends on BR2_PACKAGE_LIBCAPSIMAGE

    help
        An Atari ST/STe/TT/Falcon emulator
```

## package/retrolx/emulators/libretro/libretro-easyrpg/Config.in
```kconfig
config BR2_PACKAGE_LIBRETRO_EASYRPG
    bool "easyrpg-player"
    depends on BR2_PACKAGE_SDL2
    depends on BR2_PACKAGE_SDL2_MIXER
    depends on BR2_PACKAGE_LIBPNG
    depends on BR2_PACKAGE_ZLIB
    depends on BR2_PACKAGE_FMT
    depends on BR2_PACKAGE_FREETYPE
    depends on BR2_PACKAGE_MPG123
    depends on BR2_PACKAGE_LIBVORBIS
    depends on BR2_PACKAGE_OPUSFILE
    depends on BR2_PACKAGE_PIXMAN
    depends on BR2_PACKAGE_SPEEXDSP
    depends on BR2_PACKAGE_LIBXMP
    depends on BR2_PACKAGE_WILDMIDI
    depends on BR2_PACKAGE_LIBLCF
    help
      EasyRPG Player is a game interpreter to play RPG Maker 2000, 2003 and EasyRPG games. It uses the LCF parser library (liblcf) to read RPG Maker game data.

      EasyRPG Player is part of the EasyRPG Project. More information is available at the project website: https://easyrpg.org/
```

## package/retrolx/emulators/libretro/libretro-fbalpha2012-cps1/Config.in
```kconfig
config BR2_PACKAGE_LIBRETRO_FBALPHA2012_CPS1
        bool "libretro-fbalpha2012-cps1"
	depends on BR2_INSTALL_LIBSTDCPP
        help
          Capcom CPS-1 FBAlpha 0.2.97.24 libretro core.

	  http://www.libretro.com

comment "LIBRETRO_FBALPHA needs a toolchain w/ C++"
	depends on !BR2_INSTALL_LIBSTDCPP
```

## package/retrolx/emulators/libretro/libretro-fbalpha2012-cps2/Config.in
```kconfig
config BR2_PACKAGE_LIBRETRO_FBALPHA2012_CPS2
        bool "libretro-fbalpha2012-cps2"
	depends on BR2_INSTALL_LIBSTDCPP
        help
          Capcom CPS-2 FBAlpha 0.2.97.24 libretro core.

	  http://www.libretro.com

comment "LIBRETRO_FBALPHA needs a toolchain w/ C++"
	depends on !BR2_INSTALL_LIBSTDCPP
```

## package/retrolx/emulators/libretro/libretro-fbalpha2012-cps3/Config.in
```kconfig
config BR2_PACKAGE_LIBRETRO_FBALPHA2012_CPS3
        bool "libretro-fbalpha2012-cps3"
	depends on BR2_INSTALL_LIBSTDCPP
        help
          Capcom CPS-3 FBAlpha 0.2.97.24 libretro core.

	  http://www.libretro.com

comment "LIBRETRO_FBALPHA needs a toolchain w/ C++"
	depends on !BR2_INSTALL_LIBSTDCPP
```

## package/retrolx/emulators/libretro/libretro-fbalpha2012-neogeo/Config.in
```kconfig
config BR2_PACKAGE_LIBRETRO_FBALPHA2012_NEOGEO
        bool "libretro-fbalpha2012-neogeo"
	depends on BR2_INSTALL_LIBSTDCPP
        help
          SNK NEOGEO FBAlpha 0.2.97.24 libretro  core.

	  http://www.libretro.com

comment "LIBRETRO_FBALPHA needs a toolchain w/ C++"
	depends on !BR2_INSTALL_LIBSTDCPP
```

## package/retrolx/emulators/libretro/libretro-fbalpha2012/Config.in
```kconfig
config BR2_PACKAGE_LIBRETRO_FBALPHA2012
        bool "libretro-fbalpha2012"
	depends on BR2_INSTALL_LIBSTDCPP
        help
          A libretro fbalpha (0.2.97.40) emulator core.

	  http://www.libretro.com

comment "LIBRETRO_FBALPHA needs a toolchain w/ C++"
	depends on !BR2_INSTALL_LIBSTDCPP
```

## package/retrolx/emulators/libretro/libretro-mame2000/Config.in
```kconfig
config BR2_PACKAGE_LIBRETRO_MAME2000
        bool "libretro-mame2000"
	depends on BR2_INSTALL_LIBSTDCPP
        help
          A libretro imame4all core for ARM.

	  http://www.libretro.com

comment "LIBRETRO_MAME2000 needs a toolchain w/ C++"
	depends on !BR2_INSTALL_LIBSTDCPP
```

## package/retrolx/emulators/libretro/libretro-mupen64plus-next/Config.in
```kconfig
config BR2_PACKAGE_LIBRETRO_MUPEN64PLUS_NEXT
	bool "libretro-mupen64plus-next"
        depends on BR2_INSTALL_LIBSTDCPP

	help
	  A alternative libretro N64 emulator core
```

## package/retrolx/emulators/libretro/libretro-play/Config.in
```kconfig
config BR2_PACKAGE_LIBRETRO_PLAY
        bool "libretro-play"

        help
          A PS2 portable emulator
```

## package/retrolx/emulators/libretro/libretro-snes9x2002/Config.in
```kconfig
config BR2_PACKAGE_LIBRETRO_SNES9X2002
        bool "libretro-snes9x2002"
	depends on BR2_PACKAGE_RETROARCH
	depends on BR2_INSTALL_LIBSTDCPP
        help
          A libretro SNES emulator core for ARM.

	  http://www.libretro.com

comment "LIBRETRO_SNES9X2002 needs a toolchain w/ C++"
	depends on !BR2_INSTALL_LIBSTDCPP
```

## package/retrolx/emulators/libretro/libretro-snes9x2010/Config.in
```kconfig
config BR2_PACKAGE_LIBRETRO_SNES9X2010
        bool "libretro-snes9x2010"
	depends on BR2_INSTALL_LIBSTDCPP
        help
          A libretro SNES emulator core for ARM.

	  http://www.libretro.com

comment "LIBRETRO_SNES9X2010 needs a toolchain w/ C++"
	depends on !BR2_INSTALL_LIBSTDCPP
```

## package/retrolx/emulators/libretro/libretro-swanstation/Config.in
```kconfig
config BR2_PACKAGE_LIBRETRO_SWANSTATION
    bool "libretro-swanstation"
    depends on BR2_INSTALL_LIBSTDCPP
    depends on BR2_GCC_ENABLE_OPENMP
    depends on BR2_PACKAGE_FMT
    depends on BR2_PACKAGE_BOOST
    depends on BR2_PACKAGE_FFMPEG  
    help
      SwanStation - PlayStation 1, aka. PSX Emulator

	    https://github.com/libretro/duckstation
```
