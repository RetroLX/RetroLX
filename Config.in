## package/retrolx/core/retrolx-triggerhappy/Config.in
```kconfig
config BR2_PACKAGE_RETROLX_TRIGGERHAPPY
	bool "retrolx-triggerhappy"

	select BR2_PACKAGE_TRIGGERHAPPY
```

## package/retrolx/core/retrolx-wlinfo/Config.in
```kconfig
config BR2_PACKAGE_RETROLX_WLINFO
       bool "retrolx-wlinfo"
       depends on BR2_PACKAGE_WAYLAND
```

## package/retrolx/emulators/amiberry/Config.in
```kconfig
config BR2_PACKAGE_AMIBERRY
    bool "amiberry"
    depends on BR2_PACKAGE_SDL2
    depends on BR2_PACKAGE_SDL2_IMAGE
    depends on BR2_PACKAGE_SDL2_TTF
    depends on BR2_PACKAGE_MPG123
    depends on BR2_PACKAGE_LIBXML2
    depends on BR2_PACKAGE_LIBMPEG2
    depends on BR2_PACKAGE_FLAC
    
help
    An amiga emulator for arm
```

## package/retrolx/emulators/cemu/cemu/Config.in
```kconfig
config BR2_PACKAGE_CEMU
    bool "cemu"
    depends on BR2_x86_64
    select BR2_PACKAGE_CEMUTIL
    select BR2_PACKAGE_CEMU_HOOK

    help
      Cemu precompiled for x86_64 (needs Wine installed)

      https://cemu.info/
```

## package/retrolx/emulators/citra-android/Config.in
```kconfig
config BR2_PACKAGE_CITRA_ANDROID
    bool "citra-android"
    depends on BR2_PACKAGE_FMT
    depends on BR2_PACKAGE_BOOST
    depends on BR2_PACKAGE_FFMPEG  
    depends on BR2_PACKAGE_SDL2
    help
      A Emulator Citra core for Nintendo 3DS.

	    https://citra-emu.org/
```
