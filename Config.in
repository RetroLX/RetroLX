## package/retrolx/Config.in
```kconfig
#### packaged through pacman ####
config BR2_PACKAGE_RETROLX_PACKAGES
	bool "RetroLX pacman-managed software"

	# Include other systems
	select BR2_PACKAGE_RETROLX_ARCADE_SYSTEMS
	select BR2_PACKAGE_RETROLX_CONSOLE_SYSTEMS
	select BR2_PACKAGE_RETROLX_HANDHELD_SYSTEMS
	select BR2_PACKAGE_RETROLX_COMPUTER_SYSTEMS
	select BR2_PACKAGE_RETROLX_MSDOS_SYSTEMS
	select BR2_PACKAGE_RETROLX_HOMEBREW_SYSTEMS
	select BR2_PACKAGE_RETROLX_GAMESTREAM_SYSTEMS
	select BR2_PACKAGE_RETROLX_PORTS_SYSTEMS
	select BR2_PACKAGE_RETROLX_MULTIEMU_SYSTEMS
	select BR2_PACKAGE_RETROLX_WINE_SYSTEMS        if BR2_PACKAGE_RETROLX_IS_X86_ARCH
	select BR2_PACKAGE_RETROLX_FLASH_SYSTEMS       if BR2_PACKAGE_RETROLX_IS_X86_ARCH

	# RetroArch frontend
	select BR2_PACKAGE_RETROLX_RETROARCH

	# alternative frontends
	select BR2_PACKAGE_RETROFE
	select BR2_PACKAGE_PEGASUS		if BR2_PACKAGE_RETROLX_QT

	help
		RetroLX supported packages

config BR2_PACKAGE_RETROLX_MULTIEMU_SYSTEMS
	bool "RetroLX multisystem emulators"

	# Mednafen
	select BR2_PACKAGE_MEDNAFEN


#### Wine Layer ####
config BR2_PACKAGE_RETROLX_WINE_SYSTEMS
	bool "RetroLX Wine support"

	# Wine (windows) layer
	select BR2_PACKAGE_RETROLX_WINE    if BR2_PACKAGE_RETROLX_IS_X86_ARCH
	#select BR2_PACKAGE_WINE_X86        if BR2_PACKAGE_RETROLX_TARGET_X86_64

#### Flash Player ####
config BR2_PACKAGE_RETROLX_FLASH_SYSTEMS
	bool "RetroLX Flash support"

	# Flash Player Emulator
	select BR2_PACKAGE_RUFFLE           if BR2_PACKAGE_RETROLX_TARGET_X86_64 # depends on X11
	select BR2_PACKAGE_LIGHTSPARK       if BR2_PACKAGE_RETROLX_TARGET_X86_64 # depends on X11

#### Moonlight / Gamestream ####
config BR2_PACKAGE_RETROLX_GAMESTREAM_SYSTEMS
	bool "RetroLX game streaming support"

	# Game streaming
	select BR2_PACKAGE_MOONLIGHT_EMBEDDED if !BR2_PACKAGE_RETROLX_ROCKCHIP_ANY

#### ScummVM ####
config BR2_PACKAGE_RETROLX_SCUMMVM_SYSTEMS
	bool "RetroLX ScummVM emulators/cores"

	# ScummVM
	select BR2_PACKAGE_SCUMMVM              # ALL
	select BR2_PACKAGE_LIBRETRO_SCUMMVM     # ALL

#### Homebrew ####
config BR2_PACKAGE_RETROLX_HOMEBREW_SYSTEMS
	bool "RetroLX homebrew systems"

	# OpenBOR
	select BR2_PACKAGE_OPENBOR # ALL

	# Lutro Engine / LÖVE
	select BR2_PACKAGE_LIBRETRO_LUTRO # ALL

	# RPG engine : Solarus
	select BR2_PACKAGE_LUAJIT           if !BR2_aarch64 # for performance
	select BR2_PACKAGE_LUA              if  BR2_aarch64
	select BR2_PACKAGE_SOLARUS_ENGINE   # engine itself

	# RPG engine : EasyRPG / RPG MAker
	select BR2_PACKAGE_EASYRPG_PLAYER   # standalone
	select BR2_PACKAGE_LIBRETRO_EASYRPG # libretro core

	# Fantasy consoles
	select BR2_PACKAGE_LIBRETRO_TIC80   # ALL
	select BR2_PACKAGE_LIBRETRO_RETRO8  # ALL
	select BR2_PACKAGE_LEXALOFFLE_PICO8 # ALL

#### Sega Dreamcast, Naomi and Atomiswave ####
config BR2_PACKAGE_RETROLX_SEGADC
	bool "RetroLX dreamcast/naomi/atomiswave emulators/cores"

	# Dreamcast / Naomi / Atomiswave emulation
	select BR2_PACKAGE_FLYCAST          if  !BR2_PACKAGE_RETROLX_TARGET_RPI1       && \
                                                !BR2_PACKAGE_RETROLX_TARGET_RPI2       && \
                                                !BR2_i686

	select BR2_PACKAGE_LIBRETRO_FLYCAST     if  !BR2_PACKAGE_RETROLX_TARGET_RPI1       && \
                                                !BR2_PACKAGE_RETROLX_TARGET_RPI2       && \
                                                !BR2_i686

	select BR2_PACKAGE_REDREAM              if BR2_x86_64

	help
		Sega Dreamcast and Naomi/Atomiswave emulation support

#### Arcade cores ####
config BR2_PACKAGE_RETROLX_ARCADE_SYSTEMS
	bool "RetroLX arcade emulators packages selection"

	# Final Burn Alpha
	select BR2_PACKAGE_LIBRETRO_FBALPHA                if BR2_arm1176jzf_s || BR2_cortex_a7
	select BR2_PACKAGE_LIBRETRO_FBALPHA2012            if BR2_arm1176jzf_s || BR2_cortex_a7
	select BR2_PACKAGE_LIBRETRO_FBALPHA2012_CPS1       if BR2_arm1176jzf_s || BR2_cortex_a7
	select BR2_PACKAGE_LIBRETRO_FBALPHA2012_CPS2       if BR2_arm1176jzf_s || BR2_cortex_a7
	select BR2_PACKAGE_LIBRETRO_FBALPHA2012_CPS3       if BR2_arm1176jzf_s || BR2_cortex_a7
	select BR2_PACKAGE_LIBRETRO_FBALPHA2012_NEOGEO     if BR2_arm1176jzf_s || BR2_cortex_a7

	# Final Burn Neo
	select BR2_PACKAGE_LIBRETRO_FBNEO

	# RetroArch MAME derivatives
	select BR2_PACKAGE_LIBRETRO_MAME2000       if BR2_arm1176jzf_s || BR2_cortex_a7
	select BR2_PACKAGE_LIBRETRO_MAME2003_PLUS
	select BR2_PACKAGE_LIBRETRO_MAME2010       if !BR2_arm1176jzf_s

	#select BR2_PACKAGE_MAME     if BR2_PACKAGE_RETROLX_TARGET_X86_64 || BR2_PACKAGE_RETROLX_WAYLAND

	# Laserdic emulation
	select BR2_PACKAGE_DAPHNE               if !BR2_arm1176jzf_s && !BR2_cortex_a7

	# Naomi and Atomiswave
	select BR2_PACKAGE_RETROLX_SEGADC

	# Standalone Sega Model 3 emulator
	select BR2_PACKAGE_SUPERMODEL           if BR2_x86_64

	help
		Arcade cores/emulators

#### Handheld consoles ####
config BR2_PACKAGE_RETROLX_HANDHELD_SYSTEMS
	bool "RetroLX handheld emulation packages"

	# Gameboy / Gameboy Color
	select BR2_PACKAGE_LIBRETRO_GAMBATTE        # ALL
	select BR2_PACKAGE_LIBRETRO_TGBDUAL         # ALL

	# Watara
	select BR2_PACKAGE_LIBRETRO_WATARA          # ALL

	# GBA
	select BR2_PACKAGE_LIBRETRO_MGBA            # ALL
	select BR2_PACKAGE_LIBRETRO_VBA_M           # ALL
	select BR2_PACKAGE_LIBRETRO_GPSP            if BR2_arm1176jzf_s || BR2_cortex_a7

	# NDS
	select BR2_PACKAGE_LIBRETRO_DESMUME         if BR2_PACKAGE_RETROLX_IS_X86_ARCH
	select BR2_PACKAGE_DRASTIC                  if BR2_aarch64 && BR2_PACKAGE_RETROLX_PANFROST_MESA3D
	select BR2_PACKAGE_MELONDS                  if BR2_x86_64
	#select BR2_PACKAGE_LIBRETRO_MELONDS         if BR2_x86_64 || (BR2_aarch64 && BR2_PACKAGE_RETROLX_PANFROST_MESA3D) || BR2_PACKAGE_RETROLX_TARGET_RPI4

	# 3DS
	select BR2_PACKAGE_CITRA                    if BR2_x86_64
	select BR2_PACKAGE_LIBRETRO_CITRA           if BR2_x86_64

	# Neo Geo Pocket
	select BR2_PACKAGE_LIBRETRO_BEETLE_NGP      # ALL

	# Atari Lynx
	select BR2_PACKAGE_LIBRETRO_BEETLE_LYNX     # ALL
	select BR2_PACKAGE_LIBRETRO_HANDY           # ALL

	# Wonderswan
	select BR2_PACKAGE_LIBRETRO_BEETLE_WSWAN    # ALL

	# Pokemon Mini
	select BR2_PACKAGE_LIBRETRO_POKEMINI        # ALL

	# Game and Watch
	select BR2_PACKAGE_LIBRETRO_GW              # ALL

	# PSP
	select BR2_PACKAGE_PPSSPP                   if !BR2_arm1176jzf_s && !BR2_cortex_a7
	select BR2_PACKAGE_LIBRETRO_PPSSPP          if !BR2_arm1176jzf_s && !BR2_cortex_a7

	# Nintendo Switch
	# broken, cannot find Boost for some reason
	# select BR2_PACKAGE_YUZU                     if BR2_x86_64

	help
		Handheld cores/emulators

#### MSDOS emulation ####
config BR2_PACKAGE_RETROLX_MSDOS_SYSTEMS
	bool "RetroLX MS/DOS emulation packages"

	select BR2_PACKAGE_DOSBOX_X                 if !BR2_arm1176jzf_s && !BR2_cortex_a7

	select BR2_PACKAGE_DOSBOX_STAGING           # ALL 

	select BR2_PACKAGE_LIBRETRO_DOSBOX_PURE     # ALL

	help
		MS/DOS cores/emulators

#### Linux / Libretro ports ####
config BR2_PACKAGE_RETROLX_PORTS_SYSTEMS
	bool "RetroLX ports packages"

	# Cannonball (OutRun)
	select BR2_PACKAGE_CANNONBALL               # ALL

	# Commander Genius (Commander Keen series)
	select BR2_PACKAGE_CGENIUS		    # ALL

	# Diablo 1 engine
	select BR2_PACKAGE_DEVILUTIONX		    # ALL

	# Heroes of Might and Magic 2 engine
	select BR2_PACKAGE_FHEROES2		    # ALL

	# Heroes of Might and Magic 3 engine
	select BR2_PACKAGE_VCMI		            if !BR2_arm

	# Wolfeinstein 3D / Spear of Destiny ports
	select BR2_PACKAGE_LIBRETRO_ECWOLF          # ALL
	#select BR2_PACKAGE_ECWOLF                   if BR2_PACKAGE_RETROLX_TARGET_X86_64

	# PrBoom (Doom)
	select BR2_PACKAGE_LIBRETRO_PRBOOM          # ALL

	# TyrQuake (Quake 1)
	select BR2_PACKAGE_LIBRETRO_TYRQUAKE        # ALL

	# NxEngine (Cave Story)
	select BR2_PACKAGE_LIBRETRO_NXENGINE        # ALL

	# MrBoom (Bomberman clone)
	select BR2_PACKAGE_LIBRETRO_MRBOOM          # ALL

	# Prince of Persia
	select BR2_PACKAGE_SDLPOP                   # ALL

	# Xash3D-FWGS (Half-Life 1)
	select BR2_PACKAGE_XASH3D_FWGS              # ALL

	help
		Ports

#### Vintage computer systems ####
config BR2_PACKAGE_RETROLX_COMPUTER_SYSTEMS
	bool "RetroLX vintage computers emulation packages"

	# CAPS image support (IPF)
	select BR2_PACKAGE_LIBCAPSIMAGE         # ALL

	# Commodore 64/128/VIC20/PET/Plus4
	select BR2_PACKAGE_VICE                 # ALL
	select BR2_PACKAGE_LIBRETRO_VICE        if !BR2_arm1176jzf_s && !BR2_cortex_a7 

	# Apple II computers range
	# Deprecated LinApple to be replaced....

	# Commodore Amiga
	select BR2_PACKAGE_FSUAE                if BR2_PACKAGE_RETROLX_IS_X86_ARCH
	select BR2_PACKAGE_AMIBERRY             if !BR2_PACKAGE_RETROLX_IS_X86_ARCH
	select BR2_PACKAGE_LIBRETRO_PUAE        # ALL

	# Atari 800 computers
	select BR2_PACKAGE_LIBRETRO_ATARI800    # ALL

	# Sinclair ZX Spectrum
	select BR2_PACKAGE_LIBRETRO_FUSE        # ALL

	# Amstrad CPC
	select BR2_PACKAGE_LIBRETRO_CAP32       # ALL
	select BR2_PACKAGE_LIBRETRO_81          # ALL

	# Atari ST/TT/Falcon
	select BR2_PACKAGE_HATARI               # ALL
	select BR2_PACKAGE_LIBRETRO_HATARI      # ALL

	# MSX range
	select BR2_PACKAGE_LIBRETRO_BLUEMSX     # ALL
	select BR2_PACKAGE_LIBRETRO_FMSX        # ALL

	# Thomson 8-bit
	select BR2_PACKAGE_LIBRETRO_THEODORE    # ALL

	# Japanese PC clones
	select BR2_PACKAGE_LIBRETRO_PC88        # ALL
	select BR2_PACKAGE_LIBRETRO_PC98        # ALL

	# Sharp X68000 computer
	select BR2_PACKAGE_LIBRETRO_PX68K       # ALL

	# Sharp X1 computer
	select BR2_PACKAGE_LIBRETRO_XMIL        # ALL

	# Fujistu FM-Towns computers range
	select BR2_PACKAGE_TSUGARU              if BR2_x86_64 # FMTowns

	help
		Old computers

config BR2_PACKAGE_RETROLX_RETROARCH
	bool "RetroLX RetroArch frontend and integration"

	# RetroArch frontend and core data
	select BR2_PACKAGE_RETROARCH
	select BR2_PACKAGE_RETROLX_BEZEL
	select BR2_PACKAGE_RETROLX_SHADERS
	select BR2_PACKAGE_RETROLX_RETROACHIEVEMENTS_SOUNDS

config BR2_PACKAGE_RETROLX_CONSOLE_SYSTEMS
	bool "RetroLX console emulators/cores"

	# Nintendo NES / Famicom
	select BR2_PACKAGE_LIBRETRO_FCEUMM              # ALL
	select BR2_PACKAGE_LIBRETRO_NESTOPIA            # ALL

	# Sega 8-bit/16-range (Mark III / Master System, Game Gear, Genesis / Megadrive, SegaCD / MegaCD, 32X)
	select BR2_PACKAGE_LIBRETRO_PICODRIVE           # ALL
	select BR2_PACKAGE_LIBRETRO_GENESISPLUSGX       # ALL
	select BR2_PACKAGE_LIBRETRO_GENESISPLUSGX_WIDE  # ALL
	select BR2_PACKAGE_LIBRETRO_BLASTEM             if BR2_PACKAGE_RETROLX_IS_X86_ARCH

	# Super Nintendo / Super Famicom
	select BR2_PACKAGE_LIBRETRO_SNES9X              # ALL
	select BR2_PACKAGE_LIBRETRO_SNES9X2010          # ALL
	select BR2_PACKAGE_LIBRETRO_SNES9X2005          if BR2_arm1176jzf_s || BR2_cortex_a7
	select BR2_PACKAGE_LIBRETRO_SNES9X2002          if BR2_arm1176jzf_s || BR2_cortex_a7
	select BR2_PACKAGE_LIBRETRO_BSNES               if BR2_x86_64
	select BR2_PACKAGE_LIBRETRO_BSNES_HD            if BR2_x86_64

	# Nintendo 64
	select BR2_PACKAGE_MUPEN64PLUS		        if !BR2_arm1176jzf_s && !BR2_cortex_a7 
	select BR2_PACKAGE_LIBRETRO_MUPEN64PLUS_NEXT	if !BR2_arm1176jzf_s && !BR2_cortex_a7

	select BR2_PACKAGE_LIBRETRO_PARALLEL_N64	if BR2_x86_64  || \
							   (BR2_PACKAGE_RETROLX_PANFROST_MESA3D && !BR2_cortex_a35) || \
							   BR2_PACKAGE_RETROLX_TARGET_RPI4
	# Atari Jaguar
	select BR2_PACKAGE_LIBRETRO_VIRTUALJAGUAR       if  BR2_PACKAGE_RETROLX_IS_X86_ARCH || \
                                                        BR2_PACKAGE_RETROLX_TARGET_S922X
	# NEC PC-FX
	select BR2_PACKAGE_LIBRETRO_BEETLE_PCFX         if !BR2_arm1176jzf_s && !BR2_cortex_a7

	# Panasonic 3DO
	select BR2_PACKAGE_LIBRETRO_OPERA               if !BR2_arm1176jzf_s && !BR2_cortex_a7

	# Dreamcast
	select BR2_PACKAGE_RETROLX_SEGADC

	# Saturn
	select BR2_PACKAGE_LIBRETRO_BEETLE_SATURN       if BR2_PACKAGE_RETROLX_IS_X86_ARCH

	select BR2_PACKAGE_LIBRETRO_KRONOS              if BR2_PACKAGE_RETROLX_IS_X86_ARCH

	select BR2_PACKAGE_LIBRETRO_YABASANSHIRO        if BR2_x86_64 || BR2_PACKAGE_RETROLX_PANFROST_MESA3D || BR2_PACKAGE_RETROLX_TARGET_RPI4

	# Gamecube / Wii
	select BR2_PACKAGE_DOLPHIN_EMU                  if BR2_x86_64 || (BR2_aarch64 && BR2_PACKAGE_RETROLX_PANFROST_MESA3D && !BR2_cortex_a35) || BR2_PACKAGE_RETROLX_TARGET_RPI4

	# Microsoft XBOX
	select BR2_PACKAGE_XEMU                         if BR2_x86_64

	# Sony PS1
	select BR2_PACKAGE_DUCKSTATION                  if !BR2_arm1176jzf_s && !BR2_cortex_a7

	select BR2_PACKAGE_LIBRETRO_SWANSTATION         if  !BR2_i686 && !BR2_arm1176jzf_s && !BR2_PACKAGE_RETROLX_TARGET_RPI2

	select BR2_PACKAGE_LIBRETRO_PCSX                if !BR2_arm1176jzf_s && !BR2_cortex_a35

	select BR2_PACKAGE_LIBRETRO_BEETLE_PSX          if !BR2_arm1176jzf_s && !BR2_cortex_a7 && !BR2_cortex_a35

	# Sony PS2
	select BR2_PACKAGE_PCSX2                        if BR2_x86_64
	select BR2_PACKAGE_PLAY                         if BR2_x86_64 && BR2_PACKAGE_XORG7
	select BR2_PACKAGE_LIBRETRO_PLAY		if BR2_i686 || BR2_x86_64 || BR2_PACKAGE_RETROLX_TARGET_RPI4 || BR2_PACKAGE_RETROLX_PANFROST_MESA3D

	# Sony PS3
	select BR2_PACKAGE_RPCS3                        if BR2_x86_64

	# Wii U (requires Wine layer)
	select BR2_PACKAGE_CEMU                         if  BR2_x86_64 && BR2_PACKAGE_RETROLX_WINE_SYSTEMS

	# future pinball
	select BR2_PACKAGE_FPINBALL                     if  BR2_x86_64 && BR2_PACKAGE_RETROLX_WINE_SYSTEMS

	# SNK Neo Geo CD
	select BR2_PACKAGE_LIBRETRO_NEOCD               # ALL

	# Nintendo Virtual Boy
	select BR2_PACKAGE_LIBRETRO_BEETLE_VB           # ALL

	# NEC PC-Engine / TurboGrafx / SuperGrafx range
	select BR2_PACKAGE_LIBRETRO_BEETLE_PCE          if BR2_PACKAGE_RETROLX_IS_X86_ARCH
	select BR2_PACKAGE_LIBRETRO_BEETLE_PCE_FAST     # ALL
	select BR2_PACKAGE_LIBRETRO_BEETLE_SUPERGRAFX   # ALL

	# Vectrex
	select BR2_PACKAGE_LIBRETRO_VECX                # ALL

	# Magnavox Odyssey
	select BR2_PACKAGE_LIBRETRO_O2EM                # ALL

	# Intellivision
	select BR2_PACKAGE_LIBRETRO_FREEINTV            # ALL

	# Atari 2600
	select BR2_PACKAGE_LIBRETRO_STELLA              # ALL

	# Atari 7800
	select BR2_PACKAGE_LIBRETRO_PROSYSTEM           # ALL

	# Fairchild Channel F
	select BR2_PACKAGE_LIBRETRO_FREECHAF            # ALL

	help
		All avaible systems for the selected architecture
```

## package/retrolx/boot/amlogic-ceemmc/Config.in
```kconfig
config BR2_PACKAGE_AMLOGIC_CEEMMC
        bool "CoreELEC Amlogic eMMC install tool"
        help
          CoreELEC ceemmc tool (closed source)
```

## package/retrolx/boot/retrolx-ps4-initramfs/Config.in
```kconfig
config BR2_PACKAGE_RETROLX_PS4_INITRAMFS
	bool "RetroLX PS4 initramfs"
	default n
	help
	  PS4 custom initramfs

	  http://busybox.net/
```

## package/retrolx/boot/retrolx-syslinux-efi/Config.in
```kconfig
config BR2_PACKAGE_RETROLX_SYSLINUX_EFI
    bool "retrolx-syslinux-efi"
    help
      Precompiled syslinux EFI binaries from Archlinux

      https://www.archlinux.org/packages/core/x86_64/syslinux/
```

## package/retrolx/core/retrolx-audio/Config.in
```kconfig
config BR2_PACKAGE_RETROLX_AUDIO
	bool "retrolx-audio"
	select BR2_PACKAGE_BLUEZ_ALSA
	select BR2_PACKAGE_ALSA_UTILS
	select BR2_PACKAGE_ALSA_UTILS_AMIXER
	select BR2_PACKAGE_ALSA_UTILS_APLAY
	select BR2_PACKAGE_ALSA_PLUGINS
	help
	  Audio support and scripts for batocera.linux
```

## package/retrolx/core/retrolx-configgen/Config.in
```kconfig
config BR2_PACKAGE_RETROLX_CONFIGGEN
        bool "retrlx configgen"
	select BR2_PACKAGE_PYTHON3
	select BR2_PACKAGE_PYTHON_PYYAML
	select BR2_PACKAGE_PYTHON_PILLOW
        help
          The configuration utility for RetroLX
	  The purpose of the lib is to automatically configure emulators, using the environment variables available in RetroLX.
          The main program is emulatorlauncher.py, taking 13 parameters, that are the system and 4 controllers configurations.
```
