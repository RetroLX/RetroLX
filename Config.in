## package/retrolx/core/retrolx-system/Config.in
```kconfig
##### define variables to use in this file
if BR2_PACKAGE_RETROLX_RPI_VCORE || BR2_PACKAGE_RETROLX_RPI_MESA3D
	config BR2_PACKAGE_RETROLX_RPI_ANY
	bool "any rpi"
	default y
endif

if BR2_x86_i686 || BR2_x86_64
	config BR2_PACKAGE_RETROLX_IS_X86_ARCH
	bool "any x86 or x86_64"
	default y
endif

config BR2_PACKAGE_RETROLX_HAS_GLES2
	bool "target-gles2"

config BR2_PACKAGE_RETROLX_HAS_GLES3
	bool "target-gles3"

config BR2_PACKAGE_LIBCEC_EXYNOS_API
    bool "Exynos API in libcec"

config BR2_PACKAGE_RETROLX_CORES_EXPERIMENTAL
    bool "add experimental cores"

##########################################
config BR2_PACKAGE_RETROLX_VULKAN
	bool "RetroLX Vulkan support"

	# Wayland is required as a dependency by buildroot
	select BR2_PACKAGE_WAYLAND

	# Vulkan headers, loaders, SPIR-V, glsLang
	select BR2_PACKAGE_VULKAN_HEADERS
	select BR2_PACKAGE_VULKAN_LOADER
	select BR2_PACKAGE_SPIRV_HEADERS
	select BR2_PACKAGE_SPIRV_TOOLS
	select BR2_PACKAGE_GLSLANG
	select BR2_PACKAGE_VULKAN_TOOLS

	# Vulkan mesa drivers
	select BR2_PACKAGE_MESA3D_VULKAN_DRIVER_INTEL       if BR2_PACKAGE_RETROLX_IS_X86_ARCH
	select BR2_PACKAGE_MESA3D_VULKAN_DRIVER_AMD         if BR2_PACKAGE_RETROLX_IS_X86_ARCH
	select BR2_PACKAGE_MESA3D_VULKAN_DRIVER_BROADCOM    if BR2_PACKAGE_RETROLX_TARGET_RPI4
	select BR2_PACKAGE_MESA3D_VULKAN_DRIVER_PANFROST    if BR2_PACKAGE_RETROLX_PANFROST_MESA3D

	help
		Vulkan support for RetroLX


# RetroLX SDL2
config BR2_PACKAGE_RETROLX_SDL2
	bool "RetroLX SDL2"
	select BR2_PACKAGE_SDL2
	select BR2_PACKAGE_SDL2_GFX
	select BR2_PACKAGE_SDL2_IMAGE
	select BR2_PACKAGE_SDL2_MIXER
	select BR2_PACKAGE_SDL2_NET
	select BR2_PACKAGE_SDL2_TTF
	select BR2_PACKAGE_SDL_SOUND
	select BR2_PACKAGE_SDL2_OPENGLES
	select BR2_PACKAGE_SDL2_KMSDRM	  if !BR2_PACKAGE_RETROLX_RPI_VCORE
	select BR2_PACKAGE_SDL2_WAYLAND	  if BR2_PACKAGE_RETROLX_WAYLAND

# RetroLX Boost libraries
config BR2_PACKAGE_RETROLX_BOOST
	bool "RetroLX Boost"
	select BR2_PACKAGE_BOOST
	select BR2_PACKAGE_BOOST_ATOMIC
	select BR2_PACKAGE_BOOST_FILESYSTEM
	select BR2_PACKAGE_BOOST_CONTEXT    if BR2_PACKAGE_BOOST_CONTEXT_ARCH_SUPPORTS
	select BR2_PACKAGE_BOOST_SYSTEM
	select BR2_PACKAGE_BOOST_DATE_TIME
	select BR2_PACKAGE_BOOST_LOCALE
	select BR2_PACKAGE_BOOST_PROGRAM_OPTIONS
	select BR2_PACKAGE_BOOST_SERIALIZATION
	select BR2_PACKAGE_BOOST_THREAD

# RetroLX GTK3
config BR2_PACKAGE_RETROLX_GTK3
	bool "RetroLX GTK3"
	select BR2_PACKAGE_CAIRO_PDF
	select BR2_PACKAGE_LIBGTK3

# RetroLX audio libraries
config BR2_PACKAGE_RETROLX_AUDIO
	bool "RetroLX audio packages"
	select BR2_PACKAGE_FAAD2
	select BR2_PACKAGE_FAUDIO           if (BR2_x86_i686 || BR2_x86_64)
	select BR2_PACKAGE_FLAC
	select BR2_PACKAGE_FDK_AAC
	select BR2_PACKAGE_FLUIDSYNTH       if !BR2_arm1176jzf_s && !BR2_cortex_a7 && !BR2_cortex_a35
	select BR2_PACKAGE_JACK2
	select BR2_PACKAGE_LAME
	select BR2_PACKAGE_LIBAIO
	select BR2_PACKAGE_LIBFREEAPTX
	select BR2_PACKAGE_LIBMAD
	select BR2_PACKAGE_LIBMODPLUG
	select BR2_PACKAGE_LIBOGG
	select BR2_PACKAGE_LIBSAMPLERATE
	select BR2_PACKAGE_LIBSOUNDTOUCH
	select BR2_PACKAGE_LIBVORBIS
	select BR2_PACKAGE_LIBXMP
	select BR2_PACKAGE_MPG123
	select BR2_PACKAGE_OPENAL
	select BR2_PACKAGE_OPUS
	select BR2_PACKAGE_OPUS_FIXED_POINT if (!BR2_x86_i686 && !BR2_x86_64)
	select BR2_PACKAGE_OPUSFILE
	select BR2_PACKAGE_PULSEAUDIO
	select BR2_PACKAGE_SPEEXDSP
	select BR2_PACKAGE_TIMIDITY
	select BR2_PACKAGE_WILDMIDI

# RetroLX GStreamer infrastructure
config BR2_PACKAGE_RETROLX_GSTREAMER1
	bool "RetroLX GStreamer support"
	select BR2_PACKAGE_GSTREAMER1
	select BR2_PACKAGE_GST1_LIBAV
	select BR2_PACKAGE_GST1_PLUGINS_BASE
	select BR2_PACKAGE_GST1_PLUGINS_BASE_INSTALL_TOOLS
	select BR2_PACKAGE_GST1_PLUGINS_BASE_PLUGIN_ALSA
	select BR2_PACKAGE_GST1_PLUGINS_BASE_PLUGIN_APP
	select BR2_PACKAGE_GST1_PLUGINS_BASE_PLUGIN_AUDIOMIXER
	select BR2_PACKAGE_GST1_PLUGINS_BASE_PLUGIN_AUDIORATE
	select BR2_PACKAGE_GST1_PLUGINS_BASE_PLUGIN_COMPOSITOR
	select BR2_PACKAGE_GST1_PLUGINS_BASE_PLUGIN_VIDEOCONVERT
	select BR2_PACKAGE_GST1_PLUGINS_GOOD
	select BR2_PACKAGE_GST1_PLUGINS_GOOD_PLUGIN_AUDIOPARSERS
	select BR2_PACKAGE_GST1_PLUGINS_GOOD_PLUGIN_AUTODETECT
	select BR2_PACKAGE_GST1_PLUGINS_GOOD_PLUGIN_DEINTERLACE
	select BR2_PACKAGE_GST1_PLUGINS_GOOD_PLUGIN_MATROSKA
	select BR2_PACKAGE_GST1_PLUGINS_GOOD_PLUGIN_PULSE
	select BR2_PACKAGE_GST1_PLUGINS_GOOD_PLUGIN_VIDEOCROP
	select BR2_PACKAGE_GST1_PLUGINS_GOOD_PLUGIN_VIDEOFILTER
	select BR2_PACKAGE_GST1_PLUGINS_GOOD_PLUGIN_VIDEOMIXER
	select BR2_PACKAGE_GST1_PLUGINS_GOOD_PLUGIN_MPG123
	select BR2_PACKAGE_GST1_PLUGINS_GOOD_PLUGIN_V4L2         if !BR2_PACKAGE_RETROLX_RPI_VCORE 
	select BR2_PACKAGE_GST1_PLUGINS_GOOD_PLUGIN_V4L2_PROBE   if !BR2_PACKAGE_RETROLX_RPI_VCORE
	select BR2_PACKAGE_GST1_PLUGINS_BAD
	select BR2_PACKAGE_GST_OMX         if  BR2_PACKAGE_RETROLX_RPI_VCORE
	select BR2_PACKAGE_GST1_VAAPI      if !BR2_PACKAGE_RETROLX_RPI_VCORE

# RetroLX video libraries
config BR2_PACKAGE_RETROLX_VIDEO
	bool "RetroLX video packages"
	select BR2_PACKAGE_FFMPEG
	select BR2_PACKAGE_FFMPEG_AVRESAMPLE
	select BR2_PACKAGE_FFMPEG_GPL
	select BR2_PACKAGE_FFMPEG_SWSCALE
	select BR2_PACKAGE_FFMPEG_POSTPROC
	select BR2_PACKAGE_LIBASS
	# only needed for kodi select BR2_PACKAGE_LIBBLURAY
	select BR2_PACKAGE_LIBMPEG2
	select BR2_PACKAGE_LIBOPENH264
	select BR2_PACKAGE_LIBTHEORA
	select BR2_PACKAGE_LIBV4L           if !BR2_PACKAGE_RETROLX_RPI_VCORE
	select BR2_PACKAGE_LIBVA	    if !BR2_PACKAGE_RETROLX_RPI_VCORE
	select BR2_PACKAGE_LIBVDPAU         if BR2_PACKAGE_XORG7 
#&& !BR2_PACKAGE_RETROLX_WAYLAND
	select BR2_PACKAGE_LIBVPX
	select BR2_PACKAGE_MPV
	#select BR2_PACKAGE_RTKIT fails to compile on sbc, not so required for the moment
	select BR2_PACKAGE_X264             if (BR2_x86_i686 || BR2_x86_64)
	select BR2_PACKAGE_X265             if (BR2_x86_i686 || BR2_x86_64)


# RetroLX common libraries
config BR2_PACKAGE_RETROLX_COMMON
	bool "RetroLX common packages"
	select BR2_PACKAGE_AVAHI
	select BR2_PACKAGE_BZIP2
	select BR2_PACKAGE_CATCH2
	select BR2_PACKAGE_DBUS
	select BR2_PACKAGE_DEJAVU
	select BR2_PACKAGE_DIALOG
	select BR2_PACKAGE_ECM
	select BR2_PACKAGE_EXPAT
	select BR2_PACKAGE_EVSIEVE
	select BR2_PACKAGE_GIFLIB
	select BR2_PACKAGE_GLM
        select BR2_PACKAGE_GNUPG
	select BR2_PACKAGE_GNUTLS
	select BR2_PACKAGE_HOST_PACMAN
        select BR2_PACKAGE_HOST_RUSTC
	select BR2_PACKAGE_ICU
	select BR2_PACKAGE_JPEG_TURBO
	select BR2_PACKAGE_JSON_FOR_MODERN_CPP
	select BR2_PACKAGE_FMT
	select BR2_PACKAGE_FREETYPE
	select BR2_PACKAGE_FONTCONFIG
	select BR2_PACKAGE_HIDAPI
	select BR2_PACKAGE_LIBCEC
	select BR2_PACKAGE_LIBCURL
	select BR2_PACKAGE_LIBEVDEV
	select BR2_PACKAGE_LIBEPOXY
	select BR2_PACKAGE_LIBGLIB2
	select BR2_PACKAGE_LIBOPENSSL
	select BR2_PACKAGE_LIBPCAP
	select BR2_PACKAGE_LIBPNG
	select BR2_PACKAGE_LIBSODIUM
	select BR2_PACKAGE_LIBXML2
	select BR2_PACKAGE_LIBUSB
	select BR2_PACKAGE_LIBUSB_COMPAT
	select BR2_PACKAGE_LIBYUV
	select BR2_PACKAGE_LIBZIP
        select BR2_PACKAGE_LUAJIT
	select BR2_PACKAGE_LZ4
	select BR2_PACKAGE_LZO
	select BR2_PACKAGE_OPENSSL
	select BR2_PACKAGE_PACMAN
	select BR2_PACKAGE_PANGO
	select BR2_PACKAGE_PHYSFS
	select BR2_PACKAGE_PIPEWIRE
	select BR2_PACKAGE_PIPEWIRE_V4L2
	select BR2_PACKAGE_PIPEWIRE_MEDIA_SESSION
	select BR2_PACKAGE_PIXMAN
	select BR2_PACKAGE_PNG
	select BR2_PACKAGE_POPPLER
	select BR2_PACKAGE_POPPLER_UTILS
	select BR2_PACKAGE_PUGIXML
	select BR2_PACKAGE_RAPIDJSON
	select BR2_PACKAGE_SNAPPY
	select BR2_PACKAGE_SLIRP
	select BR2_PACKAGE_SQLITE
	select BR2_PACKAGE_UTF8PROC
	select BR2_PACKAGE_TBB
	#select BR2_PACKAGE_TRANSMISSION
	#select BR2_PACKAGE_TRANSMISSION_CLI
	#select BR2_PACKAGE_WIREPLUMBER
	#select BR2_PACKAGE_WOLFSSL
	#select BR2_PACKAGE_WOLFSSL_ALL
        select BR2_PACKAGE_UNZIP
	select BR2_PACKAGE_XZ
	select BR2_PACKAGE_ZLIB
	select BR2_PACKAGE_ZSTD


# RetroLX Python subsystem
config BR2_PACKAGE_RETROLX_PYTHON3
	bool "RetroLX Python3 packages"
	select BR2_PACKAGE_PYTHON3
	select BR2_PACKAGE_PYTHON3_HASHLIB
	select BR2_PACKAGE_PYTHON3_PY_PYC
	select BR2_PACKAGE_PYTHON3_PYEXPAT
	select BR2_PACKAGE_PYTHON_PYPARSING
	select BR2_PACKAGE_PYTHON3_SSL
	select BR2_PACKAGE_PYTHON3_UNICODEDATA
	select BR2_PACKAGE_DBUS_PYTHON    # required for bluetooth scripts
	select BR2_PACKAGE_PYTHON_GOBJECT # for bluetooth agent
	select BR2_PACKAGE_PYTHON_PROTOBUF
	select BR2_PACKAGE_PYTHON_PILLOW
	select BR2_PACKAGE_PYTHON_PSUTIL
	select BR2_PACKAGE_PYTHON_PYUDEV
	select BR2_PACKAGE_PYTHON_PYYAML
	select BR2_PACKAGE_PYTHON_SETUPTOOLS
	select BR2_PACKAGE_HOST_PYTHON3
	select BR2_PACKAGE_HOST_PYTHON_PYPARSING
	select BR2_PACKAGE_HOST_PYTHON3_SSL
	select BR2_PACKAGE_HOST_PYTHON3_PROTOBUF
	select BR2_PACKAGE_HOST_PYTHON_PYYAML

# RetroLX emulation-specific libraries (this should not exist on rootfs)
config BR2_PACKAGE_RETROLX_EMULATION_LIBRARIES
	bool "RetroLX emulation specific libraries"
	select BR2_PACKAGE_LIBLCF       # EasyRPG library
	select BR2_PACKAGE_LIBCAPSIMAGE # CAPS imaging support
	select BR2_PACKAGE_SMPQ         # MPQ Diablo tools

# RetroLX libarchive (needed for pacman)
config BR2_PACKAGE_RETROLX_LIBARCHIVE
	bool "RetroLX libarchive"
	select BR2_PACKAGE_LIBARCHIVE
	select BR2_PACKAGE_LIBARCHIVE_BSDTAR
	select BR2_PACKAGE_LIBARCHIVE_BSDCPIO
	select BR2_PACKAGE_LIBARCHIVE_BSDCAT
	select BR2_PACKAGE_HOST_LIBARCHIVE
	select BR2_PACKAGE_HOST_LIBARCHIVE_BSDTAR
	select BR2_PACKAGE_HOST_LIBARCHIVE_BSDCPIO
	select BR2_PACKAGE_HOST_LIBARCHIVE_BSDCAT


# RetroLX ALSA stack
config BR2_PACKAGE_RETROLX_ALSA
	bool "RetroLX ALSA"
	select BR2_PACKAGE_ALSA_LIB
	select BR2_PACKAGE_ALSA_LIB_SEQ
	select BR2_PACKAGE_ALSA_LIB_RAWMIDI
	select BR2_PACKAGE_ALSA_PLUGINS
	select BR2_PACKAGE_ALSA_UTILS
	select BR2_PACKAGE_SBC


# RetroLX Bluetooth stack
config BR2_PACKAGE_RETROLX_BLUETOOTH
	bool "RetroLX Bluetooth"
	select BR2_PACKAGE_BLUEZ5_UTILS
	select BR2_PACKAGE_BLUEZ5_UTILS_CLIENT
	select BR2_PACKAGE_BLUEZ5_UTILS_DEPRECATED
	select BR2_PACKAGE_BLUEZ5_UTILS_PLUGINS_SIXAXIS
	select BR2_PACKAGE_BLUEZ5_UTILS_TEST
	select BR2_PACKAGE_UTIL_LINUX_RFKILL


# RetroLX Wayland support
config BR2_PACKAGE_RETROLX_WAYLAND
	bool "RetroLX Wayland subsystem"
	select BR2_PACKAGE_LINUX_PAM
	select BR2_PACKAGE_WAYLAND
	select BR2_PACKAGE_WAYLANDPP
	select BR2_PACKAGE_WAYLAND_PROTOCOLS
	select BR2_PACKAGE_WAYLAND_UTILS
	select BR2_PACKAGE_WESTON
	select BR2_PACKAGE_WESTON_DRM
	select BR2_PACKAGE_RETROLX_WLINFO
	select BR2_PACKAGE_LIBGTK3_WAYLAND	if BR2_PACKAGE_RETROLX_GTK3
	#select BR2_PACKAGE_WESTON_XWAYLAND
	#select BR2_PACKAGE_XORG7


# RetroLX QT support
config BR2_PACKAGE_RETROLX_QT
	bool "RetroLX Qt subsystem"
	# Common Qt5 platform packages
	select BR2_PACKAGE_QT5
	select BR2_PACKAGE_QT5_VERSION_LATEST
	select BR2_PACKAGE_QT5BASE
	select BR2_PACKAGE_QT5BASE_CONCURRENT
	select BR2_PACKAGE_QT5BASE_DBUS
	select BR2_PACKAGE_QT5BASE_FONTCONFIG	
	select BR2_PACKAGE_QT5BASE_GIF		
	select BR2_PACKAGE_QT5BASE_GUI
	select BR2_PACKAGE_QT5BASE_JPEG		
	select BR2_PACKAGE_QT5BASE_OPENGL
	select BR2_PACKAGE_QT5BASE_PNG		
	select BR2_PACKAGE_QT5BASE_WIDGETS
	select BR2_PACKAGE_QT5DECLARATIVE
	select BR2_PACKAGE_QT5GAMEPAD
	select BR2_PACKAGE_QT5GRAPHICALEFFECTS
	select BR2_PACKAGE_QT5MULTIMEDIA
	select BR2_PACKAGE_QT5SVG
	select BR2_PACKAGE_QT5TOOLS
	select BR2_PACKAGE_QT5TOOLS_LINGUIST_TOOLS
	# Qt5 platform specific packages
	select BR2_PACKAGE_QT5BASE_EGLFS  
	select BR2_PACKAGE_QT5WAYLAND     if BR2_PACKAGE_RETROLX_WAYLAND
	select BR2_PACKAGE_QT5BASE_XCB    if BR2_PACKAGE_XORG7 
	select BR2_PACKAGE_QT5X11EXTRAS   if BR2_PACKAGE_XORG7

# RetroLX networking stack
config BR2_PACKAGE_RETROLX_NETWORKING
	bool "RetroLX networking components"

	select BR2_PACKAGE_AVAHI                                # service discovery on local network
	select BR2_PACKAGE_AVAHI_DAEMON                         # ping <hostname>
	select BR2_PACKAGE_AVAHI_LIBDNSSD_COMPATIBILITY         # bonjour
	select BR2_PACKAGE_CA_CERTIFICATES                      # ssl certificates
	select BR2_PACKAGE_CONNMAN                              # network manager
	select BR2_PACKAGE_CONNMAN_WIFI                         # network manager
	select BR2_PACKAGE_CONNMAN_CLIENT                       # network manager
	select BR2_PACKAGE_WIRELESS_REGDB                       # wireless regulatory database
	select BR2_PACKAGE_FPING                                # icmp tool
	select BR2_PACKAGE_LIBCURL_CURL                         # download tools
	select BR2_PACKAGE_WPA_SUPPLICANT                       # wifi
	select BR2_PACKAGE_WPA_SUPPLICANT_CLI                   # wifi
	select BR2_PACKAGE_WPA_SUPPLICANT_DBUS_INTROSPECTION    # wifi
	select BR2_PACKAGE_WPA_SUPPLICANT_WIRED                 # wpa_supplicant driver
	select BR2_PACKAGE_WPA_SUPPLICANT_WPA3                  # wifi
	select BR2_PACKAGE_WPA_SUPPLICANT_NL80211               # wpa_supplicant driver
	select BR2_PACKAGE_WPA_SUPPLICANT_WEXT                  # wpa_supplicant driver
	select BR2_PACKAGE_DROPBEAR                             # ssh server
	select BR2_PACKAGE_NTP
	select BR2_PACKAGE_RSYNC
	select BR2_PACKAGE_LIBNL                                # needed for ksmbd tools
	select BR2_PACKAGE_KSMBD_TOOLS                          # SMB linux kernel server tools
	select BR2_PACKAGE_LIBOPENSSL_BIN                       # required to encode the wifi password
	select BR2_PACKAGE_WGET                                 # download tools


config BR2_PACKAGE_RETROLX_FS_TOOLS
	bool "RetroLX filesystem and partioning packages"

	select BR2_PACKAGE_CIFS_UTILS                           # required for boot mounts
        select BR2_PACKAGE_HOST_GENIMAGE
        select BR2_PACKAGE_HOST_GENEXT2FS
        select BR2_PACKAGE_HOST_MTOOLS
	select BR2_PACKAGE_DOSFSTOOLS                           # fat
	select BR2_PACKAGE_DOSFSTOOLS_FSCK_FAT                  # fat
	select BR2_PACKAGE_DOSFSTOOLS_MKFS_FAT                  # fat
	select BR2_PACKAGE_EXFATPROGS                           # exfat (userspace)
	select BR2_PACKAGE_E2FSPROGS                            # ext4
	select BR2_PACKAGE_E2FSPROGS_RESIZE2FS                  # fs resize
	select BR2_PACKAGE_BTRFS_PROGS                          # btrfs
	select BR2_PACKAGE_MMC_UTILS                            # mmc utils
	select BR2_PACKAGE_MTD                                  # spi flash utils
	select BR2_PACKAGE_PARTED                               # partition management
	select BR2_PACKAGE_GPTFDISK                             # fs resize
	select BR2_PACKAGE_GPTFDISK_SGDISK                      # fs resize
	select BR2_PACKAGE_LIBFUSE				# fuse (flatpak requirement)


config BR2_PACKAGE_RETROLX_SYSTEM
	bool "RetroLX minimal"

	select BR2_PACKAGE_HOST_CMAKE

	# minimal system required packages
	select BR2_TARGET_RETROLX_IMAGES_DEFINITIONS
	select BR2_PACKAGE_RETROLX_INITRAMFS                   if !BR2_PACKAGE_RETROLX_TARGET_PS4 # initramfs to boot the system
	#select BR2_PACKAGE_RETROLX_PS4_INITRAMFS               if BR2_PACKAGE_RETROLX_TARGET_PS4  # initramfs to boot the system
	select BR2_PACKAGE_BASH                                 # bash shell, used as the interactive shell
	select BR2_PACKAGE_RETROLX_TRIGGERHAPPY                # multimedia/power buttons
	select BR2_TARGET_ROOTFS_SQUASHFS                       # tool to generate the target image
	select BR2_PACKAGE_PM_UTILS                             # suspend
	select BR2_PACKAGE_QTSIXA                               # ps3 pad
	select BR2_PACKAGE_QTSIXA_SHANWAN                       # ps3 pad (clone)
	select BR2_PACKAGE_XARCADE2JSTICK                       # keyboard events of the Xarcade Tankstick
	select BR2_PACKAGE_NANUM_FONT				# some font
	select BR2_PACKAGE_UTIL_LINUX_LIBMOUNT                  # for util-linux compilation to work (so, may be removed in the future)
    select BR2_PACKAGE_FBDUMP                               # tool to capture snapshots from the Linux kernel framebuffer device and write them out as a PPM file
    select BR2_PACKAGE_FBGRAB                               # framebuffer screenshot program, capturing the linux frambuffer and converting it to a png-picture
    select BR2_PACKAGE_FBV                                  # very simple graphic file viewer for the framebuffer console, capable of displaying GIF, JPEG, PNG and BMP files using libungif, libjpeg and libpng
    select BR2_PACKAGE_EUDEV_RULES_GEN                      # fork of systemd-udev with the goal of obtaining better compatibility with existing software such as OpenRC and Upstart
    
    select BR2_PACKAGE_UTIL_LINUX_LIBSMARTCOLS              # library is used for smart adaptive formatting of tabular data
    select BR2_PACKAGE_UTIL_LINUX_SETTERM                   # Set terminal attributes

	select BR2_PACKAGE_USBMOUNT                             # usb key/sd card mounter
	select BR2_PACKAGE_USBUTILS                             # usb key/sd card tools
	select BR2_PACKAGE_RETROLX_SPLASH                       # boot splash
	select BR2_PACKAGE_RETROLX_SCRIPTS                     # RETROLX scripts
	select BR2_PACKAGE_RETROLX_SETTINGS                    # RETROLX-settings-get/set
	select BR2_PACKAGE_RETROLX_AUDIO                       # RETROLX audio
	select BR2_PACKAGE_RETROLX_BLUETOOTH                   # RETROLX bluetooth
	select BR2_PACKAGE_RETROLX_NOTICE                      # boot pdf notice

	select BR2_PACKAGE_LIBDRM                               if !BR2_PACKAGE_RETROLX_RPI_VCORE
        select BR2_PACKAGE_LIBDRM_EXYNOS                        if BR2_PACKAGE_LIBDRM && BR2_PACKAGE_RETROLX_TARGET_EXYNOS5422
	select BR2_PACKAGE_RETROLX_DRMINFO                     if BR2_PACKAGE_LIBDRM
	select BR2_PACKAGE_LIBCEC                               # libcec
	select BR2_PACKAGE_EDID_DECODE                          # edid monitor/tv support
	select BR2_PACKAGE_READ_EDID                            # edid monitor/tv support
	select BR2_PACKAGE_XOW                                  # xbox receiver
	select BR2_PACKAGE_WII_U_GC_ADAPTER                     # wii-u-gc-adapter
	select BR2_SYSTEM_ENABLE_NLS                            # locales
	select BR2_PACKAGE_ACPID                                if BR2_PACKAGE_RETROLX_IS_X86_ARCH
	select BR2_PACKAGE_KBD                                  # loadkeys
	select BR2_PACKAGE_LIBXKKBCOMMON			# requirement for xkb to work, xkb is used by kodi, even without x for the keyboard
	select BR2_PACKAGE_XKEYBOARD_CONFIG                     if BR2_PACKAGE_LIBXKBCOMMON # requirement for xkb to work, xkb is used by kodi, even without x for the keyboard
	select BR2_PACKAGE_FLATPAK                              if BR2_PACKAGE_RETROLX_IS_X86_ARCH # flatpak app packaging system

	# Case
	select BR2_PACKAGE_GPICASE              if BR2_PACKAGE_RETROLX_TARGET_RPI1 # retroflag gpicase
	select BR2_PACKAGE_GPICASE2             if BR2_PACKAGE_RETROLX_TARGET_RPI4 # retroflag gpicase2
	select BR2_PACKAGE_ROSHAMBO_CASE        if BR2_PACKAGE_RETROLX_TARGET_RK3399 # roshambo case
	select BR2_PACKAGE_RPIGPIOSWITCH        if BR2_PACKAGE_RETROLX_RPI_ANY # gpio switchs
	select BR2_PACKAGE_RETROGAME            if BR2_PACKAGE_RETROLX_RPI_ANY # gpio pads

	# entropy
	select BR2_PACKAGE_RNG_TOOLS

	# irq balancing
	select BR2_PACKAGE_IRQBALANCE

	# RetroLX common base software
	select BR2_PACKAGE_RETROLX_COMMON

	# RetroLX  filesystem / partitioning required packages
	select BR2_PACKAGE_RETROLX_FS_TOOLS

	# RetroLX ALSA stack
	select BR2_PACKAGE_RETROLX_ALSA

	# RetroLX libarchive (for pacman)
	select BR2_PACKAGE_RETROLX_LIBARCHIVE

	# RetroLX Boost
	select BR2_PACKAGE_RETROLX_BOOST

	# RetroLX networking stack
	select BR2_PACKAGE_RETROLX_NETWORKING

	# RetroLX Wayland (except rpi 0/1/2)
	select BR2_PACKAGE_RETROLX_WAYLAND	if !BR2_PACKAGE_RETROLX_RPI_VCORE

	# RetroLX QT everywhere 
	select BR2_PACKAGE_RETROLX_QT

	# RetroLX SDL2
	select BR2_PACKAGE_RETROLX_SDL2

	# RetroLX audio
	select BR2_PACKAGE_RETROLX_AUDIO

	# RetroLX video
	select BR2_PACKAGE_RETROLX_VIDEO

	# RetroLX gstreamer
	select BR2_PACKAGE_RETROLX_GSTREAMER1

	# RetroLX Python
	select BR2_PACKAGE_RETROLX_PYTHON3

	# RetroLX Bluetooth
	select BR2_PACKAGE_RETROLX_BLUETOOTH

	# Vulkan
	select BR2_PACKAGE_RETROLX_VULKAN      if  BR2_PACKAGE_RETROLX_IS_X86_ARCH     || \
                                               BR2_PACKAGE_RETROLX_TARGET_RPI4 || \
                                               (BR2_PACKAGE_RETROLX_PANFROST_MESA3D && BR2_PACKAGE_RETROLX_HAS_GLES3)

	# GTK
	select BR2_PACKAGE_RETROLX_GTK3		if BR2_PACKAGE_RETROLX_IS_X86_ARCH
                                               
	# s905 tv-box firmwares
	select BR2_PACKAGE_FIRMWARE_WLAN_AML   if BR2_PACKAGE_RETROLX_TARGET_ARM64_A53_GLES2 || \
						  BR2_PACKAGE_RETROLX_TARGET_ARM64_A53_GLES3 || \
						  BR2_PACKAGE_RETROLX_TARGET_ARM64_A55_GLES3 || \
						  BR2_PACKAGE_RETROLX_TARGET_S812     || \
						  BR2_PACKAGE_RETROLX_TARGET_S922X

	# gpu drivers
	select BR2_PACKAGE_RETROLX_GPU_X86     if BR2_PACKAGE_RETROLX_IS_X86_ARCH

	# xorg
	select BR2_PACKAGE_RETROLX_XORG        if BR2_PACKAGE_RETROLX_IS_X86_ARCH

	# mangohud
	select BR2_PACKAGE_MANGOHUD             if BR2_x86_64

	# base launcher
	select BR2_PACKAGE_RETROLX_LAUNCHER

	# tools
	select BR2_PACKAGE_I2C_TOOLS
	select BR2_PACKAGE_MDADM # RAID
	select BR2_PACKAGE_MC
	select BR2_PACKAGE_FDUPES

	# required gcc flags
	# required for different emulators, i suggest to enable it always to not have different behavior depending on boards
	select BR2_GCC_ENABLE_OPENMP

	help
    	Install the RetroLX system files

config BR2_PACKAGE_RETROLX_DEV
	bool "add dev options"

	select BR2_PACKAGE_TMUX
	select BR2_PACKAGE_VIM
	select BR2_PACKAGE_X11VNC   if BR2_PACKAGE_RETROLX_IS_X86_ARCH
	select BR2_PACKAGE_KMSCUBE  if BR2_PACKAGE_MESA3D

	help
		Install dev packages for RetroLX

config BR2_PACKAGE_RETROLX_DEBUG
	bool "add debug options"

	select BR2_PACKAGE_STRACE
	select BR2_PACKAGE_GDB
	select BR2_PACKAGE_GDB_DEBUGGER
	select BR2_PACKAGE_LINUX_TOOLS_PERF
	select BR2_PACKAGE_LINUX_TOOLS_PERF_TUI
	select BR2_PACKAGE_VULKAN_SAMPLES       if BR2_PACKAGE_RETROLX_VULKAN

	help
		Install debug packages for RetroLX

config BR2_TARGET_RETROLX_IMAGES_DEFINITIONS
	bool "target images definitions"
	config BR2_TARGET_RETROLX_IMAGES
	string "target images"
	default "allwinner/aw32/cubieboard2 allwinner/aw32/bananapi-m2-zero allwinner/aw32/orangepi-one allwinner/aw32/orangepi-plus2e allwinner/aw32/orangepi-pc allwinner/aw32/orangepi-pc-plus allwinner/aw32/cha" if BR2_PACKAGE_RETROLX_TARGET_AW32
	default "allwinner/sun50i/tritium-h5 allwinner/sun50i/orangepi-pc2 allwinner/sun50i/orangepi-one-plus allwinner/sun50i/orangepi-3 amlogic/s905/odroid-c2 amlogic/s905/nanopi-k2 amlogic/s905/khadas-vim amlogic/s905/s905-tvbox rockchip/rk3328/rock64 rockchip/rk3328/roc-cc" if BR2_PACKAGE_RETROLX_TARGET_ARM64_A53_GLES2
	default "allwinner/h616/orangepi-zero2 amlogic/s905gen2/khadas-vim2 amlogic/s905gen2/radxa-zero"                                         if BR2_PACKAGE_RETROLX_TARGET_ARM64_A53_GLES3
	default "amlogic/s812"                                                                                                                   if BR2_PACKAGE_RETROLX_TARGET_S812
	default "amlogic/s905gen3/odroid-c4 amlogic/s905gen3/bananapi-m5 amlogic/s905gen3/khadas-vim3l amlogic/s905gen3/s905gen3-tvbox rockchip/rk356x/firefly-station-m2 rockchip/rk356x/firefly-station-p2" if BR2_PACKAGE_RETROLX_TARGET_ARM64_A55_GLES3
	default "amlogic/s922x/odroid-n2 amlogic/s922x/odroid-n2-plus amlogic/s922x/khadas-vim3 amlogic/s922x/gtking amlogic/s922x/gtkingpro"    if BR2_PACKAGE_RETROLX_TARGET_S922X
	default "raspberrypi/rpi1"                                                                                                               if BR2_PACKAGE_RETROLX_TARGET_RPI1
	default "raspberrypi/rpi2"                                                                                                               if BR2_PACKAGE_RETROLX_TARGET_RPI2
	default "raspberrypi/rpi3"                                                                                                               if BR2_PACKAGE_RETROLX_TARGET_RPI3
	default "raspberrypi/rpi4/rpi4"                                                                            				 if BR2_PACKAGE_RETROLX_TARGET_RPI4
	default "rockchip/rk3326/odroidgo2 rockchip/rk3326/gameforce rockchip/rk3326/rg351"                                                      if BR2_PACKAGE_RETROLX_TARGET_RK3326
	default "rockchip/rk3288/tinkerboard rockchip/rk3288/miqi"                                                                               if BR2_PACKAGE_RETROLX_TARGET_RK3288
	default "rockchip/rk3399/rock960 rockchip/rk3399/rockpro64 rockchip/rk3399/nanopi-m4 rockchip/rk3399/x99 rockchip/rk3399/rg552"		 if BR2_PACKAGE_RETROLX_TARGET_RK3399
	default "odroidxu4"                                                                                                                      if BR2_PACKAGE_RETROLX_TARGET_EXYNOS5422
	default "x86"                                                                                                                            if BR2_PACKAGE_RETROLX_TARGET_X86
	default "x86_64"                                                                                                                         if BR2_PACKAGE_RETROLX_TARGET_X86_64
	default "ps4"                                                                                                                            if BR2_PACKAGE_RETROLX_TARGET_PS4

choice
	prompt "RetroLX target"
	help
		Select RetroLX target hardware

config BR2_PACKAGE_RETROLX_TARGET_RPI1
	bool "rpi1"

config BR2_PACKAGE_RETROLX_TARGET_RPI2
	bool "rpi2"

config BR2_PACKAGE_RETROLX_TARGET_RPI3
	bool "rpi3"

config BR2_PACKAGE_RETROLX_TARGET_RPI4
	bool "rpi4"

config BR2_PACKAGE_RETROLX_TARGET_EXYNOS5422
	bool "xu4"

config BR2_PACKAGE_RETROLX_TARGET_S922X
	bool "s922x"

config BR2_PACKAGE_RETROLX_TARGET_RK3326
	bool "rk3326"

config BR2_PACKAGE_RETROLX_TARGET_X86
	bool "x86"

config BR2_PACKAGE_RETROLX_TARGET_X86_64
	bool "x86_64"

config BR2_PACKAGE_RETROLX_TARGET_PS4
	bool "ps4"

config BR2_PACKAGE_RETROLX_TARGET_RK3399
	bool "rk3399"

config BR2_PACKAGE_RETROLX_TARGET_RK3288
	bool "rk3288"

config BR2_PACKAGE_RETROLX_TARGET_AW32
	bool "aw32"

config BR2_PACKAGE_RETROLX_TARGET_S812
	bool "s812"

config BR2_PACKAGE_RETROLX_TARGET_ARM64_A53_GLES2
	bool "arm64-a53-gles2"

config BR2_PACKAGE_RETROLX_TARGET_ARM64_A53_GLES3
	bool "arm64-a53-gles3"

config BR2_PACKAGE_RETROLX_TARGET_ARM64_A55_GLES3
	bool "arm64-a55-gles3"

config BR2_PACKAGE_RETROLX_TARGET_AARCH32_SUBSYSTEM
	bool "aarch32-subsystem"

endchoice

config BR2_PACKAGE_RETROLX_EXTRAS
	bool "RetroLX tools packages selection"

	help
		Tools to extends the RETROLX system (but not required)

config BR2_PACKAGE_RETROLX_TOOLS
	bool "RetroLX system tools packages selection"

	select BR2_PACKAGE_JSTEST2          # joysticks tester
	select BR2_PACKAGE_EVTEST           # joysticks tester
	select BR2_PACKAGE_NANO             # basic nano emulator
	select BR2_PACKAGE_ZIP              # zip tool
	select BR2_PACKAGE_P7ZIP            # zip tool
	select BR2_PACKAGE_HTOP             # multi-cpus usage
	select BR2_PACKAGE_NCDU             # Disk Usage
	select BR2_PACKAGE_FFMPEG_XCBGRAB   if BR2_PACKAGE_XORG7
	select BR2_PACKAGE_SWITCHRES        if !BR2_PACKAGE_RETROLX_RPI_VCORE # switchres 15kHz

	help
		System tools

config BR2_PACKAGE_RETROLX_RPI_VCORE
	bool "RetroLX support vcore RPI"

	select BR2_PACKAGE_RPI_USERLAND
	select BR2_PACKAGE_RASPI2PNG # screenshots

config BR2_PACKAGE_RETROLX_RPI_MESA3D
	bool "RetroLX driver mesa RPI"

	select BR2_PACKAGE_MESA3D
	select BR2_PACKAGE_MESA3D_OPENGL_ES
	select BR2_PACKAGE_MESA3D_OPENGL_EGL
	select BR2_PACKAGE_MESA3D_GALLIUM_DRIVER_VC4
	select BR2_PACKAGE_MESA3D_GALLIUM_DRIVER_V3D
	select BR2_PACKAGE_MESA3D_GALLIUM_DRIVER_KMSRO

config BR2_PACKAGE_RETROLX_LIMA_MESA3D
	bool "RetroLX driver mesa LIMA"

	select BR2_PACKAGE_MESA3D
	select BR2_PACKAGE_MESA3D_OPENGL_ES
	select BR2_PACKAGE_MESA3D_OPENGL_EGL
	select BR2_PACKAGE_MESA3D_GALLIUM_DRIVER_LIMA
	select BR2_PACKAGE_MESA3D_GALLIUM_DRIVER_KMSRO

config BR2_PACKAGE_RETROLX_PANFROST_MESA3D
	bool "RetroLX driver mesa PANFROST"

	select BR2_PACKAGE_MESA3D
	select BR2_PACKAGE_MESA3D_OPENGL_ES
	select BR2_PACKAGE_MESA3D_OPENGL_EGL
	select BR2_PACKAGE_MESA3D_GALLIUM_DRIVER_PANFROST
	select BR2_PACKAGE_MESA3D_GALLIUM_DRIVER_KMSRO

config BR2_PACKAGE_RETROLX_LINUX_FIRMWARES
	bool "RetroLX Firmwares packages selection"

	select BR2_PACKAGE_ALLLINUXFIRMWARES

	# common firmwares
	select BR2_PACKAGE_UX500_FIRMWARE
	select BR2_PACKAGE_WILC1000_FIRMWARE
	select BR2_PACKAGE_ZD1211_FIRMWARE
	select BR2_PACKAGE_B43_FIRMWARE

	# x86 (maybe some firmware could be for all, to be checked)
	select BR2_PACKAGE_WILINK_BT_FIRMWARE   if BR2_PACKAGE_RETROLX_IS_X86_ARCH

config BR2_PACKAGE_RETROLX_XORG
	bool "RetroLX xorgs packages selection"

	select BR2_PACKAGE_XORG7
	select BR2_PACKAGE_XSERVER_XORG_SERVER

	# xwayland based architecture (no more ddx drivers)
	select BR2_PACKAGE_WAYLAND_PROTOCOLS
	select BR2_PACKAGE_XLIB_LIBXCOMPOSITE

	# drivers
	select BR2_PACKAGE_XDRIVER_XF86_INPUT_EVDEV
	select BR2_PACKAGE_XDRIVER_XF86_INPUT_KEYBOARD
	select BR2_PACKAGE_XDRIVER_XF86_INPUT_LIBINPUT

	# GPU drivers (needed for old Nvidia&AMD cards for edid handshake with display)
	#select BR2_PACKAGE_XDRIVER_XF86_VIDEO_AMDGPU
	#select BR2_PACKAGE_XDRIVER_XF86_VIDEO_ATI
	#select BR2_PACKAGE_XDRIVER_XF86_VIDEO_NOUVEAU
	#select BR2_PACKAGE_XDRIVER_XF86_INTEL
	select BR2_PACKAGE_RETROLX_NVIDIA_DRIVER_XORG	if BR2_PACKAGE_RETROLX_TARGET_X86_64

	# applications
	select BR2_PACKAGE_XAPP_SETXKBMAP
	select BR2_PACKAGE_XAPP_XEV
	select BR2_PACKAGE_XAPP_XINIT
	select BR2_PACKAGE_XAPP_XINPUT
	select BR2_PACKAGE_XAPP_XRANDR                  # required for resolution manipulation
	select BR2_PACKAGE_XAPP_XSET                    # X11 Xset command

	select BR2_PACKAGE_L3AFPAD                      # gtk3 text editor
	select BR2_PACKAGE_PCMANFM                      # file manager
	select BR2_PACKAGE_GVFS                         if BR2_PACKAGE_PCMANFM # file systems (trash, smb, ... in pcmanfm)
	select BR2_PACKAGE_ADWAITA_ICON_THEME_LIGHT     if BR2_PACKAGE_PCMANFM # theme for file manager

	select BR2_PACKAGE_RETROLX_DESKTOPAPPS         # RETROLX applications config and scripts
	select BR2_PACKAGE_LIBGTK3_X11			if BR2_PACKAGE_RETROLX_GTK3			
	select BR2_PACKAGE_XTERM                        # terminal
	select BR2_PACKAGE_OPENBOX                      # window manager
	#select BR2_PACKAGE_UNCLUTTER                    # hide mouse


config BR2_PACKAGE_RETROLX_GPU_X86
	bool "RetroLX GPU support for x86 platform"

	# nvidia
	select BR2_PACKAGE_LIBGLVND                            if BR2_PACKAGE_RETROLX_TARGET_X86 || BR2_PACKAGE_RETROLX_TARGET_PS4
	select BR2_PACKAGE_RETROLX_NVIDIA_DRIVER               if BR2_PACKAGE_RETROLX_TARGET_X86_64

	# mesa
	select BR2_PACKAGE_MESA3D
	#select BR2_PACKAGE_MESA3D_DRI_DRIVER_I915
	select BR2_PACKAGE_MESA3D_GALLIUM_DRIVER_CROCUS
	select BR2_PACKAGE_MESA3D_GALLIUM_DRIVER_IRIS
	select BR2_PACKAGE_MESA3D_GALLIUM_DRIVER_NOUVEAU
	select BR2_PACKAGE_MESA3D_GALLIUM_DRIVER_SWRAST
	select BR2_PACKAGE_MESA3D_GALLIUM_DRIVER_SVGA
	select BR2_PACKAGE_MESA3D_GALLIUM_DRIVER_VIRGL
	select BR2_PACKAGE_MESA3D_GALLIUM_DRIVER_R300
	select BR2_PACKAGE_MESA3D_GALLIUM_DRIVER_R600
	select BR2_PACKAGE_MESA3D_GALLIUM_DRIVER_RADEONSI
	select BR2_PACKAGE_MESA3D_OPENGL_ES
	select BR2_PACKAGE_MESA3D_OPENGL_EGL
	select BR2_PACKAGE_MESA3D_OPENGL_GLX
	select BR2_PACKAGE_MESA3D_LLVM
	select BR2_PACKAGE_MESA3D_DEMOS

	# glew / glu (desktop GL only)
        select BR2_PACKAGE_LIBGLEW
        select BR2_PACKAGE_LIBGLU

### ### ###
```
