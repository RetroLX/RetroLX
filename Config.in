## package/retrolx/core/retrolx-desktopapps/Config.in
```kconfig
config BR2_PACKAGE_RETROLX_DESKTOPAPPS
    bool "retrolx-desktopapps"
    depends on BR2_PACKAGE_XSERVER_XORG_SERVER
    depends on BR2_PACKAGE_PCMANFM # file manager
    help
      Batocera desktop applications
```

## package/retrolx/core/retrolx-drminfo/Config.in
```kconfig
config BR2_PACKAGE_RETROLX_DRMINFO
       bool "retrolx-drminfo"
       depends on BR2_PACKAGE_LIBDRM
```

## package/retrolx/core/retrolx-notice/Config.in
```kconfig
config BR2_PACKAGE_RETROLX_NOTICE
    bool "retrolx-notice"
    help
      Batocera pdf notice
```

## package/retrolx/core/retrolx-settings/Config.in
```kconfig
config BR2_PACKAGE_RETROLX_SETTINGS
	bool "retrolx-settings"

	help
	  batocera-settings-get/set binaries
```

## package/retrolx/core/retrolx-splash/Config.in
```kconfig
config BR2_PACKAGE_RETROLX_SPLASH
    bool "retrolx-splash"

    select BR2_PACKAGE_DEJAVU_SANS   if BR2_PACKAGE_RETROLX_SPLASH_OMXPLAYER
    select BR2_PACKAGE_OMXPLAYER     if BR2_PACKAGE_RETROLX_SPLASH_OMXPLAYER
    select BR2_PACKAGE_MPV           if BR2_PACKAGE_RETROLX_SPLASH_MPV
    select BR2_PACKAGE_LIBASS        if BR2_PACKAGE_RETROLX_SPLASH_MPV

    help
      RetroLX splash

choice
        prompt "splash type"
        default BR2_PACKAGE_RETROLX_SPLASH_IMAGE
        help
          Select RetroLX splash type

config BR2_PACKAGE_RETROLX_SPLASH_IMAGE
        bool "image"

config BR2_PACKAGE_RETROLX_SPLASH_ROTATE_IMAGE
        bool "rotate_image"

config BR2_PACKAGE_RETROLX_SPLASH_OMXPLAYER
        bool "omxplayer"

config BR2_PACKAGE_RETROLX_SPLASH_MPV
        bool "mpv"

endchoice
```
