## configs/batocera-kernel-s812_defconfig
```kconfig
# Target definition
BR2_arm=y
BR2_cortex_a9=y
BR2_ARM_EABIHF=y
BR2_ARM_ENABLE_NEON=y
BR2_ARM_ENABLE_VFP=y
BR2_ARM_CPU_HAS_NEON=y
BR2_ARM_FPU_NEON=y
# Toolchain definition
BR2_GCC_VERSION_10_X=y
BR2_GCC_ENABLE_GRAPHITE=y
BR2_GCC_ENABLE_LTO=y
BR2_OPTIMIZE_3=y
BR2_SHARED_STATIC_LIBS=y
BR2_TOOLCHAIN_BUILDROOT_GLIBC=y
# required for utf-8
BR2_TOOLCHAIN_GLIBC_GCONV_LIBS_COPY=y
BR2_TOOLCHAIN_BUILDROOT_CXX=y
BR2_ENABLE_LOCALE_WHITELIST="C ar ca cy_GB de el es es_MX eu_ES fr hu it ja_JP ko nb_NO nl nn_NO oc_FR.UTF-8 pl pt_PT pt_BR ru_RU uk_UA sv_SE tr zh_CN zh_TW"
BR2_GENERATE_LOCALE="en_US.UTF-8"
BR2_TARGET_OPTIMIZATION="-pipe -fsigned-char"
BR2_TARGET_GENERIC_HOSTNAME="batocera"
BR2_TARGET_GENERIC_ISSUE="PLAY AGAIN"
BR2_TARGET_ROOTFS_TAR_NONE=y
BR2_ROOTFS_DEVICE_CREATION_DYNAMIC_EUDEV=y
BR2_ROOTFS_POST_BUILD_SCRIPT="$(BR2_EXTERNAL_BATOCERA_PATH)/board/batocera/scripts/package-kernel-modules.sh"
#BR2_ROOTFS_POST_IMAGE_SCRIPT="$(BR2_EXTERNAL_BATOCERA_PATH)/board/batocera/scripts/post-image-script.sh"

#Hack
BR2_GLOBAL_PATCH_DIR="$(BR2_EXTERNAL_BATOCERA_PATH)/board/batocera/patches $(BR2_EXTERNAL_BATOCERA_PATH)/board/batocera/s812/patches"

# Linux headers same as kernel, a 5.13 series
BR2_PACKAGE_HOST_LINUX_HEADERS_CUSTOM_5_13=y

# Kernel
BR2_LINUX_KERNEL=y
BR2_LINUX_KERNEL_CUSTOM_GIT=y
BR2_LINUX_KERNEL_CUSTOM_REPO_URL="https://github.com/xdarklight/linux.git"
BR2_LINUX_KERNEL_CUSTOM_REPO_VERSION="bb00f9641efff50df02ceec0ac6843d87eedc8cb"
BR2_LINUX_KERNEL_USE_CUSTOM_CONFIG=y
BR2_LINUX_KERNEL_CUSTOM_CONFIG_FILE="$(BR2_EXTERNAL_BATOCERA_PATH)/board/batocera/s812/linux-defconfig.config"
BR2_LINUX_KERNEL_DTS_SUPPORT=y
BR2_LINUX_KERNEL_INTREE_DTS_NAME="meson8m2-mxiii meson8m2-mxiii-plus meson8m2-m8s meson8-minix-neo-x8"
BR2_LINUX_KERNEL_NEEDS_HOST_OPENSSL=y
BR2_LINUX_KERNEL_PATCH="$(BR2_EXTERNAL_BATOCERA_PATH)/board/batocera/s812/linux_patches"
BR2_LINUX_KERNEL_CONFIG_FRAGMENT_FILES="$(BR2_EXTERNAL_BATOCERA_PATH)/board/batocera/s812/linux-defconfig-fragment.config"

# S812 needed kernel changes
BR2_LINUX_KERNEL_UIMAGE=y
BR2_LINUX_KERNEL_UIMAGE_LOADADDR="0x00208000"

# Required to build ??
BR2_PACKAGE_UTIL_LINUX_LIBSMARTCOLS=y
BR2_PACKAGE_UTIL_LINUX_SETTERM=y
BR2_PACKAGE_UTIL_LINUX_LIBMOUNT=y

# spi flash support
BR2_PACKAGE_MTD=y

# Build as zstd squashfs
BR2_PACKAGE_HOST_SQUASHFS=y

# Out-of-tree kernel modules
BR2_PACKAGE_RTL8821AU=y
BR2_PACKAGE_RTL8192EU=y
BR2_PACKAGE_RTL8821CE=y
BR2_PACKAGE_RTL8723DS=y

# Enable ccache
BR2_CCACHE=y
```

## configs/retrolx-aw32_defconfig
```kconfig
# Target definition
BR2_arm=y
BR2_cortex_a7=y
BR2_ARM_EABIHF=y
BR2_ARM_FPU_NEON_VFPV4=y
BR2_PACKAGE_RETROLX_TARGET_AW32=y
BR2_PACKAGE_RETROLX_HAS_GLES2=y
BR2_ROOTFS_USERS_TABLES="$(BR2_EXTERNAL_RETROLX_PATH)/board/retrolx/users.txt"

# Toolchain definition
BR2_GCC_VERSION_11_X=y
BR2_GCC_ENABLE_GRAPHITE=y
BR2_GCC_ENABLE_LTO=y
BR2_OPTIMIZE_3=y
BR2_SHARED_STATIC_LIBS=y
BR2_TOOLCHAIN_BUILDROOT_GLIBC=y
# required for utf-8
BR2_TOOLCHAIN_GLIBC_GCONV_LIBS_COPY=y
BR2_TOOLCHAIN_BUILDROOT_CXX=y
BR2_TARGET_OPTIMIZATION="-pipe -fsigned-char -mcpu=cortex-a7 -mtune=cortex-a7"
BR2_TARGET_GENERIC_HOSTNAME="RetroLX"
BR2_TARGET_GENERIC_ISSUE="Back to the Retro"
BR2_INIT_SYSV=y
BR2_ROOTFS_DEVICE_CREATION_DYNAMIC_EUDEV=y
BR2_TARGET_GENERIC_ROOT_PASSWD="linux"
#BR2_TARGET_GENERIC_GETTY_PORT="tty1"
BR2_TARGET_GENERIC_GETTY_BAUDRATE_115200=y
# BR2_TARGET_GENERIC_REMOUNT_ROOTFS_RW is not set
BR2_ENABLE_LOCALE_WHITELIST="C ar ca cy_GB de el es es_MX eu_ES fr hu it ja_JP ko nb_NO nl nn_NO oc_FR.UTF-8 pl pt_PT pt_BR ru_RU uk_UA sv_SE tr zh_CN zh_TW"
BR2_GENERATE_LOCALE="en_US.UTF-8 ar_YE.UTF-8 ca_ES.UTF-8 cy_GB.UTF-8 de_DE.UTF-8 el_GR.UTF-8 es_ES.UTF-8 es_MX.UTF-8 eu_ES.UTF-8 fr_FR.UTF-8 hu_HU.UTF-8 it_IT.UTF-8 ja_JP.UTF-8 ko_KR.UTF-8 nb_NO.UTF-8 nl_NL.UTF-8 nn_NO.UTF-8 oc_FR.UTF-8 pl_PL.UTF-8 pt_BR.UTF-8 pt_PT.UTF-8 ru_RU.UTF-8 uk_UA.UTF-8 sv_SE.UTF-8 tr_TR.UTF-8 zh_CN.UTF-8 zh_TW.UTF-8"
BR2_TARGET_TZ_INFO=y
BR2_TARGET_LOCALTIME="Europe/Paris"
BR2_GLOBAL_PATCH_DIR="$(BR2_EXTERNAL_RETROLX_PATH)/board/retrolx/patches $(BR2_EXTERNAL_RETROLX_PATH)/board/retrolx/allwinner/aw32/patches"
BR2_ROOTFS_OVERLAY="$(BR2_EXTERNAL_RETROLX_PATH)/board/retrolx/fsoverlay $(BR2_EXTERNAL_RETROLX_PATH)/board/retrolx/allwinner/aw32/fsoverlay"
BR2_ROOTFS_POST_BUILD_SCRIPT="$(BR2_EXTERNAL_RETROLX_PATH)/board/retrolx/scripts/post-build-script.sh"
BR2_ROOTFS_POST_IMAGE_SCRIPT="$(BR2_EXTERNAL_RETROLX_PATH)/board/retrolx/scripts/post-image-script.sh"
BR2_TARGET_ROOTFS_SQUASHFS4_LZO=y
BR2_TARGET_ROOTFS_TAR_NONE=y
# BR2_TARGET_ROOTFS_TAR is not set

# Kernel
BR2_PACKAGE_RETROLX_KERNEL_AW32=y
BR2_KERNEL_HEADERS_5_15=y

BR2_PACKAGE_RETROLX_SYSTEM=y
BR2_PACKAGE_RETROLX_EXTRAS=y
BR2_PACKAGE_RETROLX_TOOLS=y
BR2_PACKAGE_RETROLX_LINUX_FIRMWARES=y
BR2_PACKAGE_LIBENET=y
BR2_PACKAGE_BUSYBOX_CONFIG_FRAGMENT_FILES="$(BR2_EXTERNAL_RETROLX_PATH)/board/retrolx/busybox.custom.config"
BR2_SYSTEM_BIN_SH_DASH=y # /bin/sh implementation; set here because a `choice` cannot be `select`ed, e.g. from batocera-system/Config.in

# Python and LUA choices
BR2_PACKAGE_PYTHON3_PY_PYC=y
BR2_PACKAGE_PYTHON_HASHLIB=y
BR2_PACKAGE_LUA_5_3=y

# GPU
BR2_PACKAGE_RETROLX_LIMA_MESA3D=y

# Filesystem tools
BR2_PACKAGE_HOST_DOSFSTOOLS=y
BR2_PACKAGE_HOST_GENIMAGE=y
BR2_PACKAGE_HOST_MTOOLS=y
BR2_PACKAGE_HOST_DTC=y
BR2_PACKAGE_HOST_SWIG=y

# wireless firmware and tools
BR2_PACKAGE_LINUX_FIRMWARE_RTL_81XX=y
BR2_PACKAGE_IW=y
BR2_PACKAGE_WIRELESS_TOOLS=y
BR2_PACKAGE_WIRELESS_TOOLS_LIB=y
BR2_PACKAGE_WPA_SUPPLICANT=y
BR2_PACKAGE_WPA_SUPPLICANT_NL80211=y
BR2_PACKAGE_WPA_SUPPLICANT_CLI=y

# RetroLX splash support
BR2_PACKAGE_RETROLX_SPLASH_IMAGE=y

# Batocera
#BR2_PACKAGE_RETROLX_DEV=y
#BR2_PACKAGE_RETROLX_DEBUG=y
#BR2_PACKAGE_RETROLX_CORES_EXPERIMENTAL=y

# RetroLX packages
BR2_PACKAGE_RETROLX_PACKAGES=y

# Enables ccache
BR2_CCACHE=y
BR2_CCACHE_DIR="$(BR2_EXTERNAL_RETROLX_PATH)/buildroot-ccache"
# Enable common downloads cache across build trees
BR2_DL_DIR="$(BR2_EXTERNAL_RETROLX_PATH)/buildroot-dlcache"
```

## package/batocera/core/batocera-drminfo/Config.in
```kconfig
config BR2_PACKAGE_RETROLX_DRMINFO
       depends on BR2_PACKAGE_LIBDRM
       bool "batocera-drminfo"
```

## package/batocera/core/batocera-notice/Config.in
```kconfig
config BR2_PACKAGE_RETROLX_NOTICE
    bool "batocera-notice"
    help
      Batocera pdf notice
```

## package/batocera/core/batocera-triggerhappy/Config.in
```kconfig
config BR2_PACKAGE_RETROLX_TRIGGERHAPPY
	bool "batocera-triggerhappy"

	select BR2_PACKAGE_TRIGGERHAPPY
```

## package/batocera/emulators/retroarch/batocera-bezel/Config.in
```kconfig
config BR2_PACKAGE_RETROLX_BEZEL
        bool "batocera bezel"
        help
          Batocera bezel

	  https://github.com/batocera-linux/batocera-bezel
```
