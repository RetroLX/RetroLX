## Config.in
```kconfig
menu "RetroLX"

menu "Kernels" 
  source "$BR2_EXTERNAL_RETROLX_PATH/package/retrolx/kernels/retrolx-kernel-aw32/Config.in" 
  source "$BR2_EXTERNAL_RETROLX_PATH/package/retrolx/kernels/retrolx-kernel-i686/Config.in" 
  source "$BR2_EXTERNAL_RETROLX_PATH/package/retrolx/kernels/retrolx-kernel-meson64/Config.in" 
  source "$BR2_EXTERNAL_RETROLX_PATH/package/retrolx/kernels/retrolx-kernel-odroidxu4/Config.in" 
  source "$BR2_EXTERNAL_RETROLX_PATH/package/retrolx/kernels/retrolx-kernel-ps4/Config.in" 
  source "$BR2_EXTERNAL_RETROLX_PATH/package/retrolx/kernels/retrolx-kernel-rk3288/Config.in" 
  source "$BR2_EXTERNAL_RETROLX_PATH/package/retrolx/kernels/retrolx-kernel-rk3326/Config.in" 
  source "$BR2_EXTERNAL_RETROLX_PATH/package/retrolx/kernels/retrolx-kernel-rk3328/Config.in" 
  source "$BR2_EXTERNAL_RETROLX_PATH/package/retrolx/kernels/retrolx-kernel-rk3399/Config.in" 
  source "$BR2_EXTERNAL_RETROLX_PATH/package/retrolx/kernels/retrolx-kernel-rk356x/Config.in" 
  source "$BR2_EXTERNAL_RETROLX_PATH/package/retrolx/kernels/retrolx-kernel-rpi1/Config.in" 
  source "$BR2_EXTERNAL_RETROLX_PATH/package/retrolx/kernels/retrolx-kernel-rpi2/Config.in" 
  source "$BR2_EXTERNAL_RETROLX_PATH/package/retrolx/kernels/retrolx-kernel-rpi3/Config.in" 
  source "$BR2_EXTERNAL_RETROLX_PATH/package/retrolx/kernels/retrolx-kernel-rpi4/Config.in" 
  source "$BR2_EXTERNAL_RETROLX_PATH/package/retrolx/kernels/retrolx-kernel-s812/Config.in" 
  source "$BR2_EXTERNAL_RETROLX_PATH/package/retrolx/kernels/retrolx-kernel-s905gen3/Config.in" 
  source "$BR2_EXTERNAL_RETROLX_PATH/package/retrolx/kernels/retrolx-kernel-s922x/Config.in" 
  source "$BR2_EXTERNAL_RETROLX_PATH/package/retrolx/kernels/retrolx-kernel-sun50i/Config.in" 
  source "$BR2_EXTERNAL_RETROLX_PATH/package/retrolx/kernels/retrolx-kernel-x86_64/Config.in"
endmenu

menu "RetroArch"
  source "$BR2_EXTERNAL_RETROLX_PATH/package/retrolx/frontends/retroarch/retroarch/Config.in"
  source "$BR2_EXTERNAL_RETROLX_PATH/package/retrolx/frontends/retroarch/retroarch-assets/Config.in"
  source "$BR2_EXTERNAL_RETROLX_PATH/package/retrolx/frontends/retroarch/shaders/common-shaders/Config.in"
  source "$BR2_EXTERNAL_RETROLX_PATH/package/retrolx/frontends/retroarch/shaders/slang-shaders/Config.in"
  source "$BR2_EXTERNAL_RETROLX_PATH/package/retrolx/frontends/retroarch/shaders/glsl-shaders/Config.in"
endmenu

menu "EmulationStation"
  source "$BR2_EXTERNAL_RETROLX_PATH/package/retrolx/frontends/emulationstation/retrolx-es-system/Config.in"
  source "$BR2_EXTERNAL_RETROLX_PATH/package/retrolx/frontends/emulationstation/retrolx-emulationstation/Config.in"
  source "$BR2_EXTERNAL_RETROLX_PATH/package/retrolx/frontends/emulationstation/es-theme-carbon/Config.in"
  source "$BR2_EXTERNAL_RETROLX_PATH/package/retrolx/frontends/emulationstation/es-theme-minijawn/Config.in"
  source "$BR2_EXTERNAL_RETROLX_PATH/package/retrolx/frontends/emulationstation/es-background-musics/Config.in"
endmenu

menu "Alt frontends"
  source "$BR2_EXTERNAL_RETROLX_PATH/package/retrolx/frontends/retrofe/Config.in"
  source "$BR2_EXTERNAL_RETROLX_PATH/package/retrolx/frontends/pegasus/Config.in"
endmenu

menu "Firmware"
  source "$BR2_EXTERNAL_RETROLX_PATH/package/retrolx/firmware/alllinuxfirmwares/Config.in"
  source "$BR2_EXTERNAL_RETROLX_PATH/package/retrolx/firmware/firmware-rockpro64/Config.in"
  source "$BR2_EXTERNAL_RETROLX_PATH/package/retrolx/firmware/firmware-wlan-aml/Config.in"
endmenu

menu "System"
  source "$BR2_EXTERNAL_RETROLX_PATH/package/retrolx/Config.in"
  source "$BR2_EXTERNAL_RETROLX_PATH/package/retrolx/core/retrolx-splash/Config.in"
  source "$BR2_EXTERNAL_RETROLX_PATH/package/retrolx/core/retrolx-configgen/Config.in"
  source "$BR2_EXTERNAL_RETROLX_PATH/package/retrolx/core/retrolx-system/Config.in"
  source "$BR2_EXTERNAL_RETROLX_PATH/package/retrolx/core/retrolx-desktopapps/Config.in"
  source "$BR2_EXTERNAL_RETROLX_PATH/package/retrolx/core/retrolx-scripts/Config.in"
  source "$BR2_EXTERNAL_RETROLX_PATH/package/retrolx/core/retrolx-triggerhappy/Config.in"
  source "$BR2_EXTERNAL_RETROLX_PATH/package/retrolx/core/retrolx-settings/Config.in"
  source "$BR2_EXTERNAL_RETROLX_PATH/package/retrolx/core/retrolx-audio/Config.in"
  source "$BR2_EXTERNAL_RETROLX_PATH/package/retrolx/core/retrolx-bluetooth/Config.in"
  source "$BR2_EXTERNAL_RETROLX_PATH/package/retrolx/core/retrolx-notice/Config.in"
  source "$BR2_EXTERNAL_RETROLX_PATH/package/retrolx/core/retrolx-drminfo/Config.in"
  source "$BR2_EXTERNAL_RETROLX_PATH/package/retrolx/core/retrolx-wlinfo/Config.in"
  source "$BR2_EXTERNAL_RETROLX_PATH/package/retrolx/core/retrolx-bezel/Config.in"
  source "$BR2_EXTERNAL_RETROLX_PATH/package/retrolx/core/retrolx-shaders/Config.in"
endmenu

menu "Boot"
  source "$BR2_EXTERNAL_RETROLX_PATH/package/retrolx/boot/amlogic-ceemmc/Config.in"
  source "$BR2_EXTERNAL_RETROLX_PATH/package/retrolx/boot/retrolx-initramfs/Config.in"
  source "$BR2_EXTERNAL_RETROLX_PATH/package/retrolx/boot/retrolx-ps4-initramfs/Config.in"
  source "$BR2_EXTERNAL_RETROLX_PATH/package/retrolx/boot/retrolx-syslinux-efi/Config.in"
  source "$BR2_EXTERNAL_RETROLX_PATH/package/retrolx/boot/uboot-odroid-xu4/Config.in"
endmenu

menu "Fonts"
  source "$BR2_EXTERNAL_RETROLX_PATH/package/retrolx/fonts/nanum-font/Config.in"
endmenu

menu "GPU"
  source "$BR2_EXTERNAL_RETROLX_PATH/package/retrolx/gpu/libmali/Config.in"
  source "$BR2_EXTERNAL_RETROLX_PATH/package/retrolx/gpu/mali-t620-wayland/Config.in"
  source "$BR2_EXTERNAL_RETROLX_PATH/package/retrolx/gpu/retrolx-nvidia-driver/Config.in"
endmenu

menu "Vulkan"
  source "$BR2_EXTERNAL_RETROLX_PATH/package/retrolx/gpu/vulkan/glslang/Config.in"
  source "$BR2_EXTERNAL_RETROLX_PATH/package/retrolx/gpu/vulkan/spirv-headers/Config.in"
  source "$BR2_EXTERNAL_RETROLX_PATH/package/retrolx/gpu/vulkan/spirv-tools/Config.in"
  source "$BR2_EXTERNAL_RETROLX_PATH/package/retrolx/gpu/vulkan/vulkan-headers/Config.in"
  source "$BR2_EXTERNAL_RETROLX_PATH/package/retrolx/gpu/vulkan/vulkan-loader/Config.in"
  source "$BR2_EXTERNAL_RETROLX_PATH/package/retrolx/gpu/vulkan/vulkan-tools/Config.in"
  source "$BR2_EXTERNAL_RETROLX_PATH/package/retrolx/gpu/vulkan/vulkan-samples/Config.in"
endmenu

menu "Controllers"
  source "$BR2_EXTERNAL_RETROLX_PATH/package/retrolx/controllers/qtsixa/Config.in"
  source "$BR2_EXTERNAL_RETROLX_PATH/package/retrolx/controllers/qtsixa-shanwan/Config.in"
  source "$BR2_EXTERNAL_RETROLX_PATH/package/retrolx/controllers/xarcade2jstick/Config.in"
  source "$BR2_EXTERNAL_RETROLX_PATH/package/retrolx/controllers/retrogame/Config.in"
  source "$BR2_EXTERNAL_RETROLX_PATH/package/retrolx/controllers/uinput-joystick/Config.in"
  source "$BR2_EXTERNAL_RETROLX_PATH/package/retrolx/controllers/wii-u-gc-adapter/Config.in"
  source "$BR2_EXTERNAL_RETROLX_PATH/package/retrolx/controllers/xow/Config.in"
endmenu

menu "Emulators"
  menu "Libretro"
      source "$BR2_EXTERNAL_RETROLX_PATH/package/retrolx/emulators/libretro/libretro-desmume/Config.in"
      source "$BR2_EXTERNAL_RETROLX_PATH/package/retrolx/emulators/libretro/libretro-blastem/Config.in"
      source "$BR2_EXTERNAL_RETROLX_PATH/package/retrolx/emulators/libretro/libretro-bluemsx/Config.in"
      source "$BR2_EXTERNAL_RETROLX_PATH/package/retrolx/emulators/libretro/libretro-gpsp/Config.in"
      source "$BR2_EXTERNAL_RETROLX_PATH/package/retrolx/emulators/libretro/libretro-gw/Config.in"
      source "$BR2_EXTERNAL_RETROLX_PATH/package/retrolx/emulators/libretro/libretro-prboom/Config.in"
      source "$BR2_EXTERNAL_RETROLX_PATH/package/retrolx/emulators/libretro/libretro-mrboom/Config.in"
      source "$BR2_EXTERNAL_RETROLX_PATH/package/retrolx/emulators/libretro/libretro-tyrquake/Config.in"
      source "$BR2_EXTERNAL_RETROLX_PATH/package/retrolx/emulators/libretro/libretro-lutro/Config.in"
      source "$BR2_EXTERNAL_RETROLX_PATH/package/retrolx/emulators/libretro/libretro-parallel-n64/Config.in"
      source "$BR2_EXTERNAL_RETROLX_PATH/package/retrolx/emulators/libretro/libretro-play/Config.in"
      source "$BR2_EXTERNAL_RETROLX_PATH/package/retrolx/emulators/libretro/libretro-nxengine/Config.in"
      source "$BR2_EXTERNAL_RETROLX_PATH/package/retrolx/emulators/libretro/libretro-freechaf/Config.in"
      source "$BR2_EXTERNAL_RETROLX_PATH/package/retrolx/emulators/libretro/libretro-prosystem/Config.in"
      source "$BR2_EXTERNAL_RETROLX_PATH/package/retrolx/emulators/libretro/libretro-tgbdual/Config.in"
      source "$BR2_EXTERNAL_RETROLX_PATH/package/retrolx/emulators/libretro/libretro-fuse/Config.in"
      source "$BR2_EXTERNAL_RETROLX_PATH/package/retrolx/emulators/libretro/libretro-o2em/Config.in"
      source "$BR2_EXTERNAL_RETROLX_PATH/package/retrolx/emulators/libretro/libretro-hatari/Config.in"
      source "$BR2_EXTERNAL_RETROLX_PATH/package/retrolx/emulators/libretro/libretro-freeintv/Config.in"
      source "$BR2_EXTERNAL_RETROLX_PATH/package/retrolx/emulators/libretro/libretro-mupen64plus-next/Config.in"
      source "$BR2_EXTERNAL_RETROLX_PATH/package/retrolx/emulators/libretro/libretro-vba-m/Config.in"
      source "$BR2_EXTERNAL_RETROLX_PATH/package/retrolx/emulators/libretro/libretro-kronos/Config.in"
      source "$BR2_EXTERNAL_RETROLX_PATH/package/retrolx/emulators/libretro/libretro-citra/Config.in"
      source "$BR2_EXTERNAL_RETROLX_PATH/package/retrolx/emulators/libretro/libretro-theodore/Config.in"
      source "$BR2_EXTERNAL_RETROLX_PATH/package/retrolx/emulators/libretro/libretro-pc88/Config.in"
      source "$BR2_EXTERNAL_RETROLX_PATH/package/retrolx/emulators/libretro/libretro-pc98/Config.in"
      source "$BR2_EXTERNAL_RETROLX_PATH/package/retrolx/emulators/libretro/libretro-tic80/Config.in"
      source "$BR2_EXTERNAL_RETROLX_PATH/package/retrolx/emulators/libretro/libretro-retro8/Config.in"
      source "$BR2_EXTERNAL_RETROLX_PATH/package/retrolx/emulators/libretro/libretro-easyrpg/Config.in"
      source "$BR2_EXTERNAL_RETROLX_PATH/package/retrolx/emulators/libretro/libretro-melonds/Config.in"
      source "$BR2_EXTERNAL_RETROLX_PATH/package/retrolx/emulators/libretro/libretro-xmil/Config.in"
      source "$BR2_EXTERNAL_RETROLX_PATH/package/retrolx/emulators/libretro/libretro-fmsx/Config.in"
      source "$BR2_EXTERNAL_RETROLX_PATH/package/retrolx/emulators/libretro/libretro-ecwolf/Config.in"
   endmenu

  menu "Standalone emulators"
    source "$BR2_EXTERNAL_RETROLX_PATH/package/retrolx/emulators/amiberry/Config.in"
    source "$BR2_EXTERNAL_RETROLX_PATH/package/retrolx/emulators/box86/box86/Config.in"
    source "$BR2_EXTERNAL_RETROLX_PATH/package/retrolx/emulators/box86/box64/Config.in"
    source "$BR2_EXTERNAL_RETROLX_PATH/package/retrolx/emulators/cemu/cemu/Config.in"
    source "$BR2_EXTERNAL_RETROLX_PATH/package/retrolx/emulators/cemu/cemu-hook/Config.in"
    source "$BR2_EXTERNAL_RETROLX_PATH/package/retrolx/emulators/cemu/cemutil/Config.in"
    source "$BR2_EXTERNAL_RETROLX_PATH/package/retrolx/emulators/citra/Config.in"
    source "$BR2_EXTERNAL_RETROLX_PATH/package/retrolx/emulators/citra-android/Config.in"
    source "$BR2_EXTERNAL_RETROLX_PATH/package/retrolx/emulators/daphne/Config.in"
    source "$BR2_EXTERNAL_RETROLX_PATH/package/retrolx/emulators/dolphin-emu/Config.in"
    source "$BR2_EXTERNAL_RETROLX_PATH/package/retrolx/emulators/dosbox-staging/Config.in"
    source "$BR2_EXTERNAL_RETROLX_PATH/package/retrolx/emulators/dosbox-x/Config.in"
    source "$BR2_EXTERNAL_RETROLX_PATH/package/retrolx/emulators/drastic/Config.in"
    source "$BR2_EXTERNAL_RETROLX_PATH/package/retrolx/emulators/duckstation/Config.in"
    source "$BR2_EXTERNAL_RETROLX_PATH/package/retrolx/emulators/easyrpg/liblcf/Config.in"
    source "$BR2_EXTERNAL_RETROLX_PATH/package/retrolx/emulators/easyrpg/easyrpg-player/Config.in"
    source "$BR2_EXTERNAL_RETROLX_PATH/package/retrolx/emulators/flash/lightspark/Config.in"
    source "$BR2_EXTERNAL_RETROLX_PATH/package/retrolx/emulators/flash/ruffle/Config.in"
    source "$BR2_EXTERNAL_RETROLX_PATH/package/retrolx/emulators/fpinball/Config.in"
    source "$BR2_EXTERNAL_RETROLX_PATH/package/retrolx/emulators/fsuae/Config.in"
    source "$BR2_EXTERNAL_RETROLX_PATH/package/retrolx/emulators/flycast/Config.in"
    source "$BR2_EXTERNAL_RETROLX_PATH/package/retrolx/emulators/gsplus/Config.in"
    source "$BR2_EXTERNAL_RETROLX_PATH/package/retrolx/emulators/hatari/Config.in"
    source "$BR2_EXTERNAL_RETROLX_PATH/package/retrolx/emulators/mame/Config.in"
    source "$BR2_EXTERNAL_RETROLX_PATH/package/retrolx/emulators/model2emu/Config.in"
    source "$BR2_EXTERNAL_RETROLX_PATH/package/retrolx/emulators/moonlight-embedded/Config.in"
    source "$BR2_EXTERNAL_RETROLX_PATH/package/retrolx/emulators/mednafen/Config.in"
    source "$BR2_EXTERNAL_RETROLX_PATH/package/retrolx/emulators/melonds/Config.in"
    source "$BR2_EXTERNAL_RETROLX_PATH/package/retrolx/emulators/openbor/Config.in"
    source "$BR2_EXTERNAL_RETROLX_PATH/package/retrolx/emulators/openbor/openbor4432/Config.in"
    source "$BR2_EXTERNAL_RETROLX_PATH/package/retrolx/emulators/openbor/openbor6330/Config.in"
    source "$BR2_EXTERNAL_RETROLX_PATH/package/retrolx/emulators/openbor/openbor6412/Config.in"
    source "$BR2_EXTERNAL_RETROLX_PATH/package/retrolx/emulators/openbor/openbor6510/Config.in"
    #pifba is deprecated
    #source "$BR2_EXTERNAL_RETROLX_PATH/package/retrolx/emulators/pifba/Config.in"
    source "$BR2_EXTERNAL_RETROLX_PATH/package/retrolx/emulators/pcsx2/Config.in"
    source "$BR2_EXTERNAL_RETROLX_PATH/package/retrolx/emulators/play/Config.in"
    source "$BR2_EXTERNAL_RETROLX_PATH/package/retrolx/emulators/ppsspp/Config.in"
    source "$BR2_EXTERNAL_RETROLX_PATH/package/retrolx/emulators/rpcs3/Config.in"
    source "$BR2_EXTERNAL_RETROLX_PATH/package/retrolx/emulators/scummvm/Config.in"
    source "$BR2_EXTERNAL_RETROLX_PATH/package/retrolx/emulators/simcoupe/Config.in"
    source "$BR2_EXTERNAL_RETROLX_PATH/package/retrolx/emulators/solarus-engine/Config.in"
    source "$BR2_EXTERNAL_RETROLX_PATH/package/retrolx/emulators/supermodel/Config.in"
    source "$BR2_EXTERNAL_RETROLX_PATH/package/retrolx/emulators/tsugaru/Config.in"
    source "$BR2_EXTERNAL_RETROLX_PATH/package/retrolx/emulators/vice/Config.in"
    source "$BR2_EXTERNAL_RETROLX_PATH/package/retrolx/emulators/vita3k/Config.in"
    source "$BR2_EXTERNAL_RETROLX_PATH/package/retrolx/emulators/xemu/Config.in"
    source "$BR2_EXTERNAL_RETROLX_PATH/package/retrolx/emulators/yuzu/Config.in"
  endmenu

  menu "Libretro cores"
      source "$BR2_EXTERNAL_RETROLX_PATH/package/retrolx/emulators/libretro/libretro-81/Config.in"
      source "$BR2_EXTERNAL_RETROLX_PATH/package/retrolx/emulators/libretro/libretro-atari800/Config.in"
      source "$BR2_EXTERNAL_RETROLX_PATH/package/retrolx/emulators/libretro/libretro-beetle-lynx/Config.in"
      source "$BR2_EXTERNAL_RETROLX_PATH/package/retrolx/emulators/libretro/libretro-beetle-ngp/Config.in"
      source "$BR2_EXTERNAL_RETROLX_PATH/package/retrolx/emulators/libretro/libretro-beetle-pce/Config.in"
      source "$BR2_EXTERNAL_RETROLX_PATH/package/retrolx/emulators/libretro/libretro-beetle-pce-fast/Config.in"
      source "$BR2_EXTERNAL_RETROLX_PATH/package/retrolx/emulators/libretro/libretro-beetle-pcfx/Config.in"
      source "$BR2_EXTERNAL_RETROLX_PATH/package/retrolx/emulators/libretro/libretro-beetle-psx/Config.in"
      source "$BR2_EXTERNAL_RETROLX_PATH/package/retrolx/emulators/libretro/libretro-beetle-saturn/Config.in"
      source "$BR2_EXTERNAL_RETROLX_PATH/package/retrolx/emulators/libretro/libretro-beetle-supergrafx/Config.in"
      source "$BR2_EXTERNAL_RETROLX_PATH/package/retrolx/emulators/libretro/libretro-beetle-wswan/Config.in"
      source "$BR2_EXTERNAL_RETROLX_PATH/package/retrolx/emulators/libretro/libretro-beetle-vb/Config.in"
      source "$BR2_EXTERNAL_RETROLX_PATH/package/retrolx/emulators/libretro/libretro-bsnes/Config.in"
      source "$BR2_EXTERNAL_RETROLX_PATH/package/retrolx/emulators/libretro/libretro-bsnes-hd/Config.in"
      source "$BR2_EXTERNAL_RETROLX_PATH/package/retrolx/emulators/libretro/libretro-cap32/Config.in"
      source "$BR2_EXTERNAL_RETROLX_PATH/package/retrolx/emulators/libretro/libretro-dosbox-pure/Config.in"
      # fbalpha is deprecated
      #source "$BR2_EXTERNAL_RETROLX_PATH/package/retrolx/emulators/libretro/libretro-fbalpha/Config.in"
      #source "$BR2_EXTERNAL_RETROLX_PATH/package/retrolx/emulators/libretro/libretro-fbalpha2012/Config.in"
      #source "$BR2_EXTERNAL_RETROLX_PATH/package/retrolx/emulators/libretro/libretro-fbalpha2012-cps1/Config.in"
      #source "$BR2_EXTERNAL_RETROLX_PATH/package/retrolx/emulators/libretro/libretro-fbalpha2012-cps2/Config.in"
      #source "$BR2_EXTERNAL_RETROLX_PATH/package/retrolx/emulators/libretro/libretro-fbalpha2012-cps3/Config.in"
      #source "$BR2_EXTERNAL_RETROLX_PATH/package/retrolx/emulators/libretro/libretro-fbalpha2012-neogeo/Config.in"
      source "$BR2_EXTERNAL_RETROLX_PATH/package/retrolx/emulators/libretro/libretro-fbneo/Config.in"
      source "$BR2_EXTERNAL_RETROLX_PATH/package/retrolx/emulators/libretro/libretro-fceumm/Config.in"
      source "$BR2_EXTERNAL_RETROLX_PATH/package/retrolx/emulators/libretro/libretro-flycast/Config.in"
      source "$BR2_EXTERNAL_RETROLX_PATH/package/retrolx/emulators/libretro/libretro-gambatte/Config.in"
      source "$BR2_EXTERNAL_RETROLX_PATH/package/retrolx/emulators/libretro/libretro-genesisplusgx/Config.in"
      source "$BR2_EXTERNAL_RETROLX_PATH/package/retrolx/emulators/libretro/libretro-genesisplusgx-wide/Config.in"
      source "$BR2_EXTERNAL_RETROLX_PATH/package/retrolx/emulators/libretro/libretro-handy/Config.in"
      source "$BR2_EXTERNAL_RETROLX_PATH/package/retrolx/emulators/libretro/libretro-mame2000/Config.in"
      source "$BR2_EXTERNAL_RETROLX_PATH/package/retrolx/emulators/libretro/libretro-mame2003-plus/Config.in"
      source "$BR2_EXTERNAL_RETROLX_PATH/package/retrolx/emulators/libretro/libretro-mame2010/Config.in"
      source "$BR2_EXTERNAL_RETROLX_PATH/package/retrolx/emulators/libretro/libretro-mgba/Config.in"
      source "$BR2_EXTERNAL_RETROLX_PATH/package/retrolx/emulators/libretro/libretro-neocd/Config.in"
      source "$BR2_EXTERNAL_RETROLX_PATH/package/retrolx/emulators/libretro/libretro-nestopia/Config.in"
      source "$BR2_EXTERNAL_RETROLX_PATH/package/retrolx/emulators/libretro/libretro-opera/Config.in"
      source "$BR2_EXTERNAL_RETROLX_PATH/package/retrolx/emulators/libretro/libretro-picodrive/Config.in"
      source "$BR2_EXTERNAL_RETROLX_PATH/package/retrolx/emulators/libretro/libretro-pcsx/Config.in"
      source "$BR2_EXTERNAL_RETROLX_PATH/package/retrolx/emulators/libretro/libretro-pokemini/Config.in"
      source "$BR2_EXTERNAL_RETROLX_PATH/package/retrolx/emulators/libretro/libretro-ppsspp/Config.in"
      source "$BR2_EXTERNAL_RETROLX_PATH/package/retrolx/emulators/libretro/libretro-puae/Config.in"
      source "$BR2_EXTERNAL_RETROLX_PATH/package/retrolx/emulators/libretro/libretro-px68k/Config.in"
      source "$BR2_EXTERNAL_RETROLX_PATH/package/retrolx/emulators/libretro/libretro-scummvm/Config.in"
      source "$BR2_EXTERNAL_RETROLX_PATH/package/retrolx/emulators/libretro/libretro-snes9x/Config.in"
      source "$BR2_EXTERNAL_RETROLX_PATH/package/retrolx/emulators/libretro/libretro-snes9x2002/Config.in"
      source "$BR2_EXTERNAL_RETROLX_PATH/package/retrolx/emulators/libretro/libretro-snes9x2005/Config.in"
      source "$BR2_EXTERNAL_RETROLX_PATH/package/retrolx/emulators/libretro/libretro-snes9x2010/Config.in"
      source "$BR2_EXTERNAL_RETROLX_PATH/package/retrolx/emulators/libretro/libretro-stella/Config.in"
      source "$BR2_EXTERNAL_RETROLX_PATH/package/retrolx/emulators/libretro/libretro-swanstation/Config.in"
      source "$BR2_EXTERNAL_RETROLX_PATH/package/retrolx/emulators/libretro/libretro-vecx/Config.in"
      source "$BR2_EXTERNAL_RETROLX_PATH/package/retrolx/emulators/libretro/libretro-vice/Config.in"
      source "$BR2_EXTERNAL_RETROLX_PATH/package/retrolx/emulators/libretro/libretro-virtualjaguar/Config.in"
      source "$BR2_EXTERNAL_RETROLX_PATH/package/retrolx/emulators/libretro/libretro-watara/Config.in"
      source "$BR2_EXTERNAL_RETROLX_PATH/package/retrolx/emulators/libretro/libretro-yabasanshiro/Config.in"
  endmenu

  menu "Ports"
    source "$BR2_EXTERNAL_RETROLX_PATH/package/retrolx/ports/abuse/Config.in"
    source "$BR2_EXTERNAL_RETROLX_PATH/package/retrolx/ports/cannonball/Config.in"
    source "$BR2_EXTERNAL_RETROLX_PATH/package/retrolx/ports/cdogs/Config.in"
    source "$BR2_EXTERNAL_RETROLX_PATH/package/retrolx/ports/cgenius/Config.in"
    source "$BR2_EXTERNAL_RETROLX_PATH/package/retrolx/ports/devilutionx/Config.in"
    source "$BR2_EXTERNAL_RETROLX_PATH/package/retrolx/ports/ecwolf/Config.in"
    source "$BR2_EXTERNAL_RETROLX_PATH/package/retrolx/ports/fheroes2/Config.in"
    source "$BR2_EXTERNAL_RETROLX_PATH/package/retrolx/ports/hcl/Config.in"
    source "$BR2_EXTERNAL_RETROLX_PATH/package/retrolx/ports/hurrican/Config.in"
    source "$BR2_EXTERNAL_RETROLX_PATH/package/retrolx/ports/sdlpop/Config.in"
    source "$BR2_EXTERNAL_RETROLX_PATH/package/retrolx/ports/vcmi/Config.in"
    source "$BR2_EXTERNAL_RETROLX_PATH/package/retrolx/ports/xash3d/Config.in"
    source "$BR2_EXTERNAL_RETROLX_PATH/package/retrolx/ports/xash3d/xash3d-fwgs/Config.in"
    source "$BR2_EXTERNAL_RETROLX_PATH/package/retrolx/ports/xash3d/hlsdk-xash3d/Config.in"
    source "$BR2_EXTERNAL_RETROLX_PATH/package/retrolx/ports/xash3d/hlsdk-xash3d-dmc/Config.in"
    source "$BR2_EXTERNAL_RETROLX_PATH/package/retrolx/ports/xash3d/hlsdk-xash3d-opfor/Config.in"
  endmenu

  menu "mupen64plus"
    source "$BR2_EXTERNAL_RETROLX_PATH/package/retrolx/emulators/mupen64plus/Config.in"
    source "$BR2_EXTERNAL_RETROLX_PATH/package/retrolx/emulators/mupen64plus/mupen64plus-core/Config.in"
    source "$BR2_EXTERNAL_RETROLX_PATH/package/retrolx/emulators/mupen64plus/mupen64plus-uiconsole/Config.in"
    source "$BR2_EXTERNAL_RETROLX_PATH/package/retrolx/emulators/mupen64plus/mupen64plus-gles2/Config.in"
    source "$BR2_EXTERNAL_RETROLX_PATH/package/retrolx/emulators/mupen64plus/mupen64plus-video-glide64mk2/Config.in"
    source "$BR2_EXTERNAL_RETROLX_PATH/package/retrolx/emulators/mupen64plus/mupen64plus-video-rice/Config.in"
    source "$BR2_EXTERNAL_RETROLX_PATH/package/retrolx/emulators/mupen64plus/mupen64plus-omx/Config.in"
    source "$BR2_EXTERNAL_RETROLX_PATH/package/retrolx/emulators/mupen64plus/mupen64plus-input-sdl/Config.in"
    source "$BR2_EXTERNAL_RETROLX_PATH/package/retrolx/emulators/mupen64plus/mupen64plus-audio-sdl/Config.in"
    source "$BR2_EXTERNAL_RETROLX_PATH/package/retrolx/emulators/mupen64plus/mupen64plus-rsphle/Config.in"
    source "$BR2_EXTERNAL_RETROLX_PATH/package/retrolx/emulators/mupen64plus/mupen64plus-gliden64/Config.in"
  endmenu

  menu "Wine"
    source "$BR2_EXTERNAL_RETROLX_PATH/package/retrolx/utils/retrolx-wine/Config.in"
    source "$BR2_EXTERNAL_RETROLX_PATH/package/retrolx/wine/dxvk/Config.in"
    source "$BR2_EXTERNAL_RETROLX_PATH/package/retrolx/wine/mf/Config.in"
    source "$BR2_EXTERNAL_RETROLX_PATH/package/retrolx/wine/rtkit/Config.in"
    source "$BR2_EXTERNAL_RETROLX_PATH/package/retrolx/wine/vkd3d-proton/Config.in"
    source "$BR2_EXTERNAL_RETROLX_PATH/package/retrolx/wine/vkd3d/Config.in"
    source "$BR2_EXTERNAL_RETROLX_PATH/package/retrolx/wine/wine-mono-proton/Config.in"
    source "$BR2_EXTERNAL_RETROLX_PATH/package/retrolx/wine/wine-mono-lutris/Config.in"
    source "$BR2_EXTERNAL_RETROLX_PATH/package/retrolx/wine/wine-lutris/Config.in"
    source "$BR2_EXTERNAL_RETROLX_PATH/package/retrolx/wine/wine-lutris-wow64_32/Config.in"
    source "$BR2_EXTERNAL_RETROLX_PATH/package/retrolx/wine/wine-proton/Config.in"
    source "$BR2_EXTERNAL_RETROLX_PATH/package/retrolx/wine/wine-proton-wow64_32/Config.in"
    source "$BR2_EXTERNAL_RETROLX_PATH/package/retrolx/wine/wine-x86/Config.in"
    source "$BR2_EXTERNAL_RETROLX_PATH/package/retrolx/wine/winetricks/Config.in"
  endmenu

endmenu

menu "Looks"
  source "$BR2_EXTERNAL_RETROLX_PATH/package/retrolx/looks/adwaita-icon-theme-light/Config.in"
endmenu

menu "Utils"
  source "$BR2_EXTERNAL_RETROLX_PATH/package/retrolx/utils/evsieve/Config.in"
  source "$BR2_EXTERNAL_RETROLX_PATH/package/retrolx/utils/mangohud/Config.in"
  source "$BR2_EXTERNAL_RETROLX_PATH/package/retrolx/utils/re2c/Config.in"
  source "$BR2_EXTERNAL_RETROLX_PATH/package/retrolx/utils/switchres/Config.in"
  source "$BR2_EXTERNAL_RETROLX_PATH/package/retrolx/utils/raspi2png/Config.in"
  source "$BR2_EXTERNAL_RETROLX_PATH/package/retrolx/utils/gpicase/Config.in"
  source "$BR2_EXTERNAL_RETROLX_PATH/package/retrolx/utils/gpicase2/Config.in"
  source "$BR2_EXTERNAL_RETROLX_PATH/package/retrolx/utils/rpigpioswitch/Config.in"
  source "$BR2_EXTERNAL_RETROLX_PATH/package/retrolx/utils/jstest2/Config.in"
  source "$BR2_EXTERNAL_RETROLX_PATH/package/retrolx/utils/xosd/Config.in"
  source "$BR2_EXTERNAL_RETROLX_PATH/package/retrolx/utils/unclutter/Config.in"
  source "$BR2_EXTERNAL_RETROLX_PATH/package/retrolx/utils/roshambo-case/Config.in"
  source "$BR2_EXTERNAL_RETROLX_PATH/package/retrolx/utils/fdupes/Config.in"
  source "$BR2_EXTERNAL_RETROLX_PATH/package/retrolx/utils/cabextract/Config.in"
  source "$BR2_EXTERNAL_RETROLX_PATH/package/retrolx/utils/pacman/Config.in"
  source "$BR2_EXTERNAL_RETROLX_PATH/package/retrolx/utils/evmapy-system-config/Config.in"
  source "$BR2_EXTERNAL_RETROLX_PATH/package/retrolx/utils/l3afpad/Config.in"
  source "$BR2_EXTERNAL_RETROLX_PATH/package/retrolx/utils/flatpak/Config.in"
  source "$BR2_EXTERNAL_RETROLX_PATH/package/retrolx/utils/pm-utils/Config.in"
endmenu

menu "Libraries"
  source "$BR2_EXTERNAL_RETROLX_PATH/package/retrolx/libraries/appstream-glib/Config.in"
  source "$BR2_EXTERNAL_RETROLX_PATH/package/retrolx/libraries/catch2/Config.in"
  source "$BR2_EXTERNAL_RETROLX_PATH/package/retrolx/libraries/ecm/Config.in"
  source "$BR2_EXTERNAL_RETROLX_PATH/package/retrolx/libraries/faudio/Config.in"
  source "$BR2_EXTERNAL_RETROLX_PATH/package/retrolx/libraries/ksmbd-tools/Config.in"
  source "$BR2_EXTERNAL_RETROLX_PATH/package/retrolx/libraries/libcapsimage/Config.in"
  source "$BR2_EXTERNAL_RETROLX_PATH/package/retrolx/libraries/libxmp/Config.in"
  source "$BR2_EXTERNAL_RETROLX_PATH/package/retrolx/libraries/libfreeaptx/Config.in"
  source "$BR2_EXTERNAL_RETROLX_PATH/package/retrolx/libraries/libenet/Config.in"
  source "$BR2_EXTERNAL_RETROLX_PATH/package/retrolx/libraries/libglvnd/Config.in"
  source "$BR2_EXTERNAL_RETROLX_PATH/package/retrolx/libraries/tbb/Config.in"
  source "$BR2_EXTERNAL_RETROLX_PATH/package/retrolx/libraries/wildmidi/Config.in"
  source "$BR2_EXTERNAL_RETROLX_PATH/package/retrolx/libraries/wxwidgets/Config.in"
endmenu

menu "Soundfonts"
  source "$BR2_EXTERNAL_RETROLX_PATH/package/retrolx/soundfonts/retrolx-fluid-soundfont/Config.in"
endmenu

endmenu
```
